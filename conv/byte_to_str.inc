;-----------------------------------------------------------------------------------------------------------------------
;Файл распространяется под лицензией GPL-3.0-or-later, https://www.gnu.org/licenses/gpl-3.0.txt
;-----------------------------------------------------------------------------------------------------------------------
;07.10.2019	w5277c@gmail.com			Начало
;01.08.2020	w5277c@gmail.com			Разбиение на файлы
;27.10.2020	w5277c@gmail.com			Обновлена информация об авторских правах
;10.12.2020	w5277c@gmail.com			-с5
;18.10.2021	w5277c@gmail.com			Оптимизация
;-----------------------------------------------------------------------------------------------------------------------
.ifdef DEF_BYTE_TO_STR
.else
.set DEF_BYTE_TO_STR = 1

.if REPORT_INCLUDES == 0x01
.message "included BYTE_TO_STR"
.endif

.include	"./math/div16x8.inc"
;--------------------------------------------------------
BYTE_TO_STR:
;--------------------------------------------------------
;Конвертирование числа в 3 символа
;IN: TEMP-число
;OUT: TEMP_H/L/TEMP-3 ASCII символа(0,0x30-0x39)
;--------------------------------------------------------
	LDI TEMP_H,0x00
	MOV TEMP_L,TEMP
	LDI TEMP,0x0a
	MCALL DIV16x8
	PUSH TEMP
	LDI TEMP,0x0a
	MCALL DIV16x8
	MOV TEMP_H,TEMP_L
	SUBI TEMP_H,(0x100-0x30)										;+0x30
	MOV TEMP_L,TEMP
	SUBI TEMP_L,(0x100-0x30)										;+0x30
	POP TEMP
	SUBI TEMP,(0x100-0x30)											;+0x30
	RET
.endif
