;-----------------------------------------------------------------------------------------------------------------------
;Файл распространяется под лицензией GPL-3.0-or-later, https://www.gnu.org/licenses/gpl-3.0.txt
;-----------------------------------------------------------------------------------------------------------------------
;05.01.2021	w5277c@gmail.com			Начало
;-----------------------------------------------------------------------------------------------------------------------
;TODO отказаться от T
;-----------------------------------------------------------------------------------------------------------------------
.ifdef DEF_NUM_TO_7SEG
.else
.set DEF_NUM_TO_7SEG = 1

.if REPORT_INCLUDES == 0x01
.message "included NUM_TO_7SEG"
.endif

_NUM_TO_7SEG__TABLE:
	.db	0b11111100,0b01100000,0b11011010,0b11110000,0b01100110,\
			0b10110110,0b10111110,0b11100000,0b11111110,0b11110110
;--------------------------------------------------------
NUM_TO_7SEG:
;--------------------------------------------------------
;Конвертирование числа в биты 7-сегментного индикатора
;IN: TEMP-число(0-9)
;OUT: TEMP-биты(T,TR,BR,B,BL,TL,C,D)
;--------------------------------------------------------
	PUSH_Z

	LDI_Z _NUM_TO_7SEG__TABLE*2
	ADD ZL,TEMP
	ADC ZH,C0x00
	LD TEMP,Z

	POP_Z
	RET
.endif
