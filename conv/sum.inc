;-----------------------------------------------------------------------------------------------------------------------
;Файл распространяется под лицензией GPL-3.0-or-later, https://www.gnu.org/licenses/gpl-3.0.txt
;-----------------------------------------------------------------------------------------------------------------------
;27.09.2021  w5277c@gmail.com			Начало
;-----------------------------------------------------------------------------------------------------------------------
.ifdef DEF_SUM
.else
.set DEF_SUM = 1

.if REPORT_INCLUDES == 0x01
.message "included SUM"
.endif

;--------------------------------------------------------
SUM:
;--------------------------------------------------------
;Сумма блока
;IN: X-адрес начала блока, LOOP_CNTR-длина
;OUT: ACCUM-сумма
;--------------------------------------------------------
	PUSH_X
	PUSH LOOP_CNTR
	PUSH TEMP

	CLR ACCUM
_SUM__LOOP:
	LD TEMP,X+
	ADD ACCUM,TEMP
	DEC LOOP_CNTR
	BRNE _SUM__LOOP

	POP TEMP
	POP LOOP_CNTR
	POP_X
	RET
.endif
