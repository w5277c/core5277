;-----------------------------------------------------------------------------------------------------------------------
;Файл распространяется под лицензией GPL-3.0-or-later, https://www.gnu.org/licenses/gpl-3.0.txt
;-----------------------------------------------------------------------------------------------------------------------
;07.10.2019	w5277c@gmail.com		Начало
;01.08.2020	w5277c@gmail.com		Разбиение на файлы
;27.10.2020	w5277c@gmail.com		Обновлена информация об авторских правах
;05.12.2020	w5277c@gmail.com		-с5
;28.12.2020	w5277c@gmail.com		;Переделал на табличный вариант
;03.11.2024	konstantin@5277.ru		Вынесена таблица
;-----------------------------------------------------------------------------------------------------------------------

.ifdef DEF_BITNUM_TO_NUM
.else
.set DEF_BITNUM_TO_NUM = 1

.if REPORT_INCLUDES == 0x01
.message "included BITNUM_TO_NUM"
.endif

.include	"./conv/_bitnum_to_num_table.inc"

;-----------------------------------------------------------
BITNUM_TO_NUM:
;-----------------------------------------------------------
;Номер бита в число(2^n)
;IN: TEMP-номер бита(0-7)
;OUT: TEMP-число(1,2,4,8,16,32,64,128)
;-----------------------------------------------------------
	PUSH_Z													;4
	LDI_Z _BITNUM_TO_NUM_TABLE*2							;2
	ADD ZL,TEMP												;1
	ADC ZH,C0x00											;1
	LPM TEMP,Z												;3
	POP_Z													;4,total:15t
	RET
.endif

