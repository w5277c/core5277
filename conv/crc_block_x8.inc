;-----------------------------------------------------------------------------------------------------------------------
;Файл распространяется под лицензией GPL-3.0-or-later, https://www.gnu.org/licenses/gpl-3.0.txt
;-----------------------------------------------------------------------------------------------------------------------
;19.01.2021  w5277c@gmail.com			Начало
;-----------------------------------------------------------------------------------------------------------------------
.ifdef DEF_CRC_BLOCK_X8
.else
.set DEF_CRC_BLOCK_X8 = 1

;--------------------------------------------------------
CRC_BLOCK_X8:
;--------------------------------------------------------
;Подсчет блока CRC
;IN: X-адрес начала блока, LOOP_CNTR - длина
;Y-адрес процедуры для вычисления байта
;OUT: ACCUM - сумма
;--------------------------------------------------------
	PUSH_X
	PUSH LOOP_CNTR
	CLR ACCUM

_CRCX_BLOCK_X8__LOOP:
	LDI TEMP,low(_CRC_BLOCK_X8__CODEPOINT)
	PUSH TEMP
	LDI TEMP,high(_CRC_BLOCK_X8__CODEPOINT)
	PUSH TEMP
	PUSH YL
	PUSH YH
	LD TEMP,X+
	RET
_CRC_BLOCK_X8__CODEPOINT:
	DEC LOOP_CNTR
	BRNE _CRCX_BLOCK_X8__LOOP

	POP LOOP_CNTR
	POP_X
	RET
.endif
