;-----------------------------------------------------------------------------------------------------------------------
;Файл распространяется под лицензией GPL-3.0-or-later, https://www.gnu.org/licenses/gpl-3.0.txt
;-----------------------------------------------------------------------------------------------------------------------
;08.01.2022	w5277c@gmail.com			Начало
;-----------------------------------------------------------------------------------------------------------------------
.ifdef DEF_BCD_TO_BYTE
.else
.set DEF_BCD_TO_BYTE = 1

.if REPORT_INCLUDES == 0x01
.message "included BCD_TO_BYTE"
.endif

.include "./math/mul10.inc"

;--------------------------------------------------------
BCD_TO_BYTE:
;--------------------------------------------------------
;Конвертация BCD числа в байт
;IN: TEMP-BCD байт
;OUT: TEMP-число
;--------------------------------------------------------
	PUSH TEMP_H
	PUSH TEMP_L

	PUSH TEMP
	SWAP TEMP
	ANDI TEMP,0x0f
	MCALL MUL10
	POP TEMP
	ANDI TEMP,0x0f
	ADD TEMP,TEMP_L
	
	POP TEMP_L
	POP TEMP_H
	RET
.endif
