;-----------------------------------------------------------------------------------------------------------------------
;Файл распространяется под лицензией GPL-3.0-or-later, https://www.gnu.org/licenses/gpl-3.0.txt
;-----------------------------------------------------------------------------------------------------------------------
;27.01.2021	w5277c@gmail.com			Начало (не тестировано)
;18.10.2021	w5277c@gmail.com			Оптимизация
;-----------------------------------------------------------------------------------------------------------------------
.ifdef DEF_NUMX32_TO_STRF
.else
.set DEF_NUMX32_TO_STRF = 1

.include	"./math/div32x16.inc"

;--------------------------------------------------------
NUM32_TO_STRF:
;--------------------------------------------------------
;Запись 4Б числа в виде строки
;IN: TEMP_EH/EL/H/L-32b слово, Z-dst адрес
;OUT: Z-новое смещение
;--------------------------------------------------------
	PUSH_FT
	PUSH LOOP_CNTR
	PUSH_X

	ADIW ZL,0x0a

	LDI LOOP_CNTR,0x09
_NUM32_TO_STRF__LOOP:
	LDI_X 0x0a
	MCALL DIV32x16
	SUBI XL,(0x100-0x30)
	ST -Z,XL
	DEC LOOP_CNTR
	BRNE _NUM32_TO_STRF__LOOP
	SUBI TEMP_L,(0x100-0x30)
	ST -Z,TEMP_L
	ADIW ZL,0x0a

	POP_X
	POP LOOP_CNTR
	POP_FT
	RET
.endif
