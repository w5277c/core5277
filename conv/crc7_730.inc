;-----------------------------------------------------------------------------------------------------------------------
;Файл распространяется под лицензией GPL-3.0-or-later, https://www.gnu.org/licenses/gpl-3.0.txt
;-----------------------------------------------------------------------------------------------------------------------
;19.01.2021  w5277c@gmail.com			Начало
;-----------------------------------------------------------------------------------------------------------------------
.ifdef DEF_CRC7_730
.else
.set DEF_CRC7_730 = 1

;--------------------------------------------------------
CRC7_730:
;--------------------------------------------------------
;Подсчет CRC7 (x^7 + x^3 + x^0)
;IN: TEMP - байт, ACCUM - сумма
;OUT: ACCUM - сумма
;--------------------------------------------------------
	PUSH TEMP_L
	PUSH LOOP_CNTR

	LDI TEMP_L,0x12
	EOR ACCUM,TEMP
	LDI LOOP_CNTR,0x08
_CRC7_730__LOOP:
	LSL ACCUM
	BRCC PC+0x02
	EOR ACCUM,TEMP_L
	DEC LOOP_CNTR
	BRNE _CRC7_730__LOOP

	POP LOOP_CNTR
	POP TEMP_L
	RET
.endif
