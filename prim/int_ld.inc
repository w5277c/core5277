;-----------------------------------------------------------------------------------------------------------------------
;Файл распространяется под лицензией GPL-3.0-or-later, https://www.gnu.org/licenses/gpl-3.0.txt
;-----------------------------------------------------------------------------------------------------------------------
;06.02.2021	w5277c@gmail.com			Начало
;03.07.2021	w5277c@gmail.com			Z->Y
;-----------------------------------------------------------------------------------------------------------------------
.ifdef DEF_INT_LD
.else
.set DEF_INT_LD = 1

.if REPORT_INCLUDES == 0x01
.message "included INT_LD"
.endif

.include	"./prim/_offsets.inc"

;--------------------------------------------------------
INT_LD:
;--------------------------------------------------------
;Запись значения для INT
;IN: Y-адрес на память с переменными, TEMP-смещение для
;записи значения, TEMP_EH/EL/H/L-значение
;--------------------------------------------------------
	PUSH TEMP
	PUSH_Y

	ADD YL,TEMP
	ADC YH,C0x00

	STD Y+0x00,TEMP_EH
	STD Y+0x01,TEMP_EL
	STD Y+0x02,TEMP_H
	STD Y+0x03,TEMP_L

	POP_Y
	POP TEMP
	RET
.endif
