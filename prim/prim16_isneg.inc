;-----------------------------------------------------------------------------------------------------------------------
;Файл распространяется под лицензией GPL-3.0-or-later, https://www.gnu.org/licenses/gpl-3.0.txt
;-----------------------------------------------------------------------------------------------------------------------
;04.02.2024	w5277c@gmail.com			Начало
;-----------------------------------------------------------------------------------------------------------------------
.ifdef DEF_PRIM16_ISNEG
.else
.set DEF_PRIM16_ISNEG = 1

.if REPORT_INCLUDES == 0x01
.message "included PRIM16_ISNEG"
.endif

;--------------------------------------------------------
PRIM16_ISNEG:
;--------------------------------------------------------
;Отрицательное значение(включен старший бит)?
;IN: Y-адрес на память с переменными, X-смещение на
;переменную
;OUT: Флаг Z(true - отрицательное)
;--------------------------------------------------------
	PUSH_X
	PUSH TEMP

	ADD XL,YL
	ADC XH,YH
	LD TEMP,X
	COM TEMP
	ANDI TEMP,0x80

	POP TEMP
	POP_X
	RET
