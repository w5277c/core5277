;-----------------------------------------------------------------------------------------------------------------------
;Файл распространяется под лицензией GPL-3.0-or-later, https://www.gnu.org/licenses/gpl-3.0.txt
;-----------------------------------------------------------------------------------------------------------------------
;04.02.2024	w5277c@gmail.com			Начало
;-----------------------------------------------------------------------------------------------------------------------
.ifdef DEF_PRIM16_ELD
.else
.set DEF_PRIM16_ELD = 1

.if REPORT_INCLUDES == 0x01
.message "included PRIM16_ELD"
.endif

.include "./mem/eeprom_read_bytes.inc"

;--------------------------------------------------------
PRIM16_ELD:
;--------------------------------------------------------
;Чтение примитива с EEPROM
;IN: Y-адрес на память с переменными, X-смещение на
;переменную, TEMP_H/L-адрес в EEPROM,
;ACCUM-тип примитива
;--------------------------------------------------------
	PUSH_X
	PUSH LOOP_CNTR

	ADD XL,YL
	ADC XH,YH
	ANDI ACCUM,0x0f
	MOV LOOP_CNTR,ACCUM
	MCALL EEPROM_READ_BYTES

	POP LOOP_CNTR
	POP_X
	RET
