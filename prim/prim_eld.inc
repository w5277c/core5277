;-----------------------------------------------------------------------------------------------------------------------
;Файл распространяется под лицензией GPL-3.0-or-later, https://www.gnu.org/licenses/gpl-3.0.txt
;-----------------------------------------------------------------------------------------------------------------------
;04.02.2024	w5277c@gmail.com			Начало
;-----------------------------------------------------------------------------------------------------------------------
.ifdef DEF_PRIM_ELD
.else
.set DEF_PRIM_ELD = 1

.if REPORT_INCLUDES == 0x01
.message "included PRIM_ELD"
.endif

.include "./prim/_common16.inc"
.include "./mem/eeprom_read_bytes.inc"

;--------------------------------------------------------
PRIM_ELD:
;--------------------------------------------------------
;Чтение примитива с EEPROM
;IN: Y-адрес на память с переменными, XL-смещение на
;переменную, TEMP_H/L-адрес в EEPROM,
;ACCUM-тип примитива
;--------------------------------------------------------
	PUSH_X
	PUSH LOOP_CNTR

	CLR XH
	ADD XL,YL
	ADC XH,YH
	ANDI ACCUM,0x0f
	MOV LOOP_CNTR,ACCUM
	MCALL EEPROM_READ_BYTES

	POP LOOP_CNTR
	POP_X
	RET
