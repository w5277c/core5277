;-----------------------------------------------------------------------------------------------------------------------
;Файл распространяется под лицензией GPL-3.0-or-later, https://www.gnu.org/licenses/gpl-3.0.txt
;-----------------------------------------------------------------------------------------------------------------------
;05.01.2021  w5277c@gmail.com			Начало
;-----------------------------------------------------------------------------------------------------------------------
.ifdef DEF_PRIM_OFFSETS
.else
.set DEF_PRIM_OFFSETS = 1

;--------------------------------------------------------
_PRIM_OFFSETS_R:
;--------------------------------------------------------
;Вычисляет адреса по смещениям
;IN: Z-адрес на память с переменными, TEMP_H-смещение1,
;TEMP_L-смещение2,ACCUM-тип примитива
;OUT: Z-адрес1, X-адрес2
;--------------------------------------------------------
	PUSH TEMP
	PUSH ACCUM

	ANDI ACCUM,0x0f
	CLR TEMP
	CLR XH
	MOV XL,TEMP_L
	ADD XL,ACCUM
	ADC XH,TEMP
	ADD XL,ZL
	ADC XH,ZH
	ADD ZL,TEMP_H
	ADC ZH,TEMP
	ADD ZL,ACCUM
	ADC ZH,TEMP

	POP ACCUM
	POP TEMP
	RET

;--------------------------------------------------------
_PRIM_OFFSETS_L:
;--------------------------------------------------------
;Вычисляет адреса по смещениям
;IN: Z-адрес на память с переменными, TEMP_H-смещение1,
;TEMP_L-смещение2,ACCUM-тип примитива
;OUT: Z-адрес1, X-адрес2
;--------------------------------------------------------
	PUSH TEMP

	CLR TEMP
	CLR XH
	MOV XL,TEMP_L
	ADD XL,ZL
	ADC XH,ZH
	ADD ZL,TEMP_H
	ADC ZH,TEMP

	POP TEMP
	RET

.endif
