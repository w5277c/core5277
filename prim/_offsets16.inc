;-----------------------------------------------------------------------------------------------------------------------
;Файл распространяется под лицензией GPL-3.0-or-later, https://www.gnu.org/licenses/gpl-3.0.txt
;-----------------------------------------------------------------------------------------------------------------------
;04.02.2024	w5277c@gmail.com			Начало
;-----------------------------------------------------------------------------------------------------------------------
.ifdef DEF_PRIM16_OFFSETS
.else
.set DEF_PRIM16_OFFSETS = 1

;--------------------------------------------------------
_PRIM16_OFFSETS_R:
;--------------------------------------------------------
;Вычисляет адреса по смещениям(младший байт)
;IN: Y-адрес на память с переменными, X-смещение1,
;Z-смещение2,ACCUM-тип примитива
;OUT: X-адрес1, Z-адрес2
;--------------------------------------------------------
	PUSH ACCUM

	ANDI ACCUM,0x0f
	ADD XL,YL
	ADC XH,YH
	ADD XL,ACCUM
	ADC XH,C0x00
	ADD ZL,YL
	ADC ZH,YH
	ADD ZL,ACCUM
	ADC ZH,C0x00

	POP ACCUM
	RET

;--------------------------------------------------------
_PRIM16_OFFSETS_L:
;--------------------------------------------------------
;Вычисляет адреса по смещениям(старший байт)
;IN: Y-адрес на память с переменными, X-смещение1,
;Z-смещение2,ACCUM-тип примитива
;OUT: X-адрес1, Z-адрес2
;--------------------------------------------------------
	ADD XL,YL
	ADC XH,YH
	ADD ZL,YL
	ADC ZH,YH
	RET
.endif
