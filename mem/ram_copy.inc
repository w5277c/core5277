;-----------------------------------------------------------------------------------------------------------------------
;Файл распространяется под лицензией GPL-3.0-or-later, https://www.gnu.org/licenses/gpl-3.0.txt
;-----------------------------------------------------------------------------------------------------------------------
;07.10.2019	w5277c@gmail.com			Начало
;01.08.2020	w5277c@gmail.com			Разбиение на файлы
;27.10.2020	w5277c@gmail.com			Обновлена информация об авторских правах
;05.12.2020	w5277c@gmail.com			-с5
;-----------------------------------------------------------------------------------------------------------------------
;TODO: убрать 8 из имени у всех 8битных процедур, число нужно только не 8битным процедурам
;-----------------------------------------------------------------------------------------------------------------------
.ifdef DEF_RAM_COPY
.else
.set DEF_RAM_COPY = 1

.if REPORT_INCLUDES == 0x01
.message "included RAM_COPY"
.endif

.include	"./mem/ram_copy16.inc"

;--------------------------------------------------------
RAM_COPY:
;--------------------------------------------------------
;Копирование блока памяти
;IN: X-SRC адрес, Z-DST адрес, LOOP_CNTR-длина
;--------------------------------------------------------
	PUSH TEMP_H
	PUSH TEMP_L
	CLR TEMP_H
	MOV TEMP_L,LOOP_CNTR
	MCALL RAM_COPY16
	POP TEMP_L
	POP TEMP_H
	RET
.endif
