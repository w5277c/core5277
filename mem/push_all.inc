;-----------------------------------------------------------------------------------------------------------------------
;Файл распространяется под лицензией GPL-3.0-or-later, https://www.gnu.org/licenses/gpl-3.0.txt
;-----------------------------------------------------------------------------------------------------------------------
;11.08.2022	w5277c@gmail.com			Начало
;-----------------------------------------------------------------------------------------------------------------------
.ifdef DEF_PUSH_ALL
.else
.set DEF_PUSH_ALL = 1

.if REPORT_INCLUDES == 0x01
.message "included PUSH_ALL"
.endif

;--------------------------------------------------------
PUSH_ALL:
;--------------------------------------------------------
;Помещаем в стек все старшие 16 регистров
;--------------------------------------------------------
	POP _RESULT_L
	POP _RESULT_H
	PUSH r16
	PUSH r17
	PUSH r18
	PUSH r19
	PUSH r20
	PUSH r21
	PUSH r22
	PUSH r23
	PUSH r24
	PUSH r25
	PUSH r26
	PUSH r27
	PUSH r28
	PUSH r29
	PUSH r30
	PUSH r31
	PUSH _RESULT_H
	PUSH _RESULT_L
	RET
