;-----------------------------------------------------------------------------------------------------------------------
;Файл распространяется под лицензией GPL-3.0-or-later, https://www.gnu.org/licenses/gpl-3.0.txt
;-----------------------------------------------------------------------------------------------------------------------
;28.05.2020  w5277c@gmail.com        Начало
;01.08.2020  w5277c@gmail.com        Разбиение на файлы
;27.10.2020  w5277c@gmail.com        Обновлена информация об авторских правах
;-----------------------------------------------------------------------------------------------------------------------
.ifdef DEF_C5_RAM_DEFRAG
.else
.set DEF_C5_RAM_DEFRAG = 1

.if REPORT_INCLUDES == 0x01
.message "included C5_RAM_DEFRAG"
.endif

;--------------------------------------------------------
C5_RAM_DEFRAG:
;--------------------------------------------------------
;Дефрагментация памяти, т.е. по сути, сдвигает выделенный
;блок в начало памяти, если перед задачей есть свободное
;пространство.
;Задача может вызывать этот метод для общей экономии
;памяти. При этом адресация меняется, т.е. задача не
;должна иметь смещений на что-либо внутри старого блока
;памяти.
;IN: PID
;--------------------------------------------------------
	MCALL C5_DISPATCHER_LOCK
	;TODO
	MCALL C5_DISPATCHER_UNLOCK
	RET
.endif
