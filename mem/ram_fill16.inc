;-----------------------------------------------------------------------------------------------------------------------
;Файл распространяется под лицензией GPL-3.0-or-later, https://www.gnu.org/licenses/gpl-3.0.txt
;-----------------------------------------------------------------------------------------------------------------------
;07.10.2019	w5277c@gmail.com			Начало
;01.08.2020	w5277c@gmail.com			Разбиение на файлы
;27.10.2020	w5277c@gmail.com			Обновлена информация об авторских правах
;05.12.2020	w5277c@gmail.com			с5
;15.08.2020	w5277c@gmail.com			Оптимизация
;-----------------------------------------------------------------------------------------------------------------------
.ifdef DEF_RAM_FILL16
.else
.set DEF_RAM_FILL16 = 1

.if REPORT_INCLUDES == 0x01
.message "included RAM_FILL16"
.endif

;--------------------------------------------------------
RAM_FILL16:
;--------------------------------------------------------
;Заполнение блока памяти значением
;IN: X-адрес, TEMP-значение, TEMP_H/TEMP_L-длина
;--------------------------------------------------------
	PUSH_X
	PUSH_Y

	MOV YH,TEMP_H
	MOV YL,TEMP_L
_RAM_FILL16__LOOP:
	ST X+,TEMP
	SBIW YL,0x01
	BRNE _RAM_FILL16__LOOP

	POP_Y
	POP_X
	RET
.endif
