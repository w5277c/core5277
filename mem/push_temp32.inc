;-----------------------------------------------------------------------------------------------------------------------
;Файл распространяется под лицензией GPL-3.0-or-later, https://www.gnu.org/licenses/gpl-3.0.txt
;-----------------------------------------------------------------------------------------------------------------------
;11.08.2022	w5277c@gmail.com			Начало
;-----------------------------------------------------------------------------------------------------------------------
.ifdef DEF_PUSH_TEMP32
.else
.set DEF_PUSH_TEMP32 = 1

.if REPORT_INCLUDES == 0x01
.message "included PUSH_TEMP32"
.endif

;--------------------------------------------------------
PUSH_TEMP32:
;--------------------------------------------------------
;Помещаем в стек TEMP_EH,EL,H,L
;--------------------------------------------------------
	POP _RESULT_L
	POP _RESULT_H
	PUSH TEMP_EH
	PUSH TEMP_EL
	PUSH TEMP_H
	PUSH TEMP_L
	PUSH _RESULT_H
	PUSH _RESULT_L
	RET
