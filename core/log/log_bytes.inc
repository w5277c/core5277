;-----------------------------------------------------------------------------------------------------------------------
;Файл распространяется под лицензией GPL-3.0-or-later, https://www.gnu.org/licenses/gpl-3.0.txt
;-----------------------------------------------------------------------------------------------------------------------
;12.06.2020	w5277c@gmail.com        Начало
;01.08.2020	w5277c@gmail.com        Разбиение на файлы
;13.09.2020	w5277c@gmail.com        Восстанавливаем Y
;27.10.2020	w5277c@gmail.com        Обновлена информация об авторских правах
;05.07.2021	w5277c@gmail.com			Z->Y
;-----------------------------------------------------------------------------------------------------------------------
.ifdef DEF_C5_LOG_BYTES
.else
.set DEF_C5_LOG_BYTES = 1
.ifdef LOGGING_PORT

.include	"./core/log/log_byte.inc"
;--------------------------------------------------------
C5_LOG_BYTES:
;--------------------------------------------------------
;Логируем блок данных
;IN: Z-адрес начала блока, TEMP-длина блока
;--------------------------------------------------------
	PUSH TEMP
	PUSH LOOP_CNTR
	PUSH_Z

	MOV LOOP_CNTR,TEMP
_C5_LOG_BYTES__LOOP:
	LD TEMP,Z+
	MCALL C5_LOG_BYTE
	DEC LOOP_CNTR
	BRNE _C5_LOG_BYTES__LOOP

	POP_Z
	POP LOOP_CNTR
	POP TEMP
	RET
.endif
.endif
