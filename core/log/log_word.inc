;-----------------------------------------------------------------------------------------------------------------------
;Файл распространяется под лицензией GPL-3.0-or-later, https://www.gnu.org/licenses/gpl-3.0.txt
;-----------------------------------------------------------------------------------------------------------------------
;12.06.2020  w5277c@gmail.com        Начало
;01.08.2020  w5277c@gmail.com        Разбиение на файлы
;27.10.2020  w5277c@gmail.com        Обновлена информация об авторских правах
;-----------------------------------------------------------------------------------------------------------------------
.ifdef DEF_C5_LOG_WORD
.else
.set DEF_C5_LOG_WORD = 1
.ifdef LOGGING_PORT

.include	"./core/log/log_byte.inc"

;--------------------------------------------------------
C5_LOG_WORD:
;--------------------------------------------------------
;Логирование слова как HEX строки
;IN: TEMP_H/TEMP_L - слово
;--------------------------------------------------------
	PUSH TEMP
	MOV TEMP,TEMP_H
	MCALL C5_LOG_BYTE
	MOV TEMP,TEMP_L
	MCALL C5_LOG_BYTE
	POP TEMP
	RET
.endif
.endif
