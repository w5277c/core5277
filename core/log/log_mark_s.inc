;-----------------------------------------------------------------------------------------------------------------------
;Файл распространяется под лицензией GPL-3.0-or-later, https://www.gnu.org/licenses/gpl-3.0.txt
;-----------------------------------------------------------------------------------------------------------------------
;12.06.2020	w5277c@gmail.com        Начало
;02.08.2020	w5277c@gmail.com        Разбиение на файлы
;27.10.2020	w5277c@gmail.com        Обновлена информация об авторских правах
;-----------------------------------------------------------------------------------------------------------------------
.ifdef DEF_C5_LOG_MARK_S
.else
.set DEF_C5_LOG_MARK_S = 1
.ifdef LOGGING_PORT

.include	"./core/log/log_char.inc"

.MACRO C5_LOG_MARK_S
	PUSH TEMP
	LDI TEMP,@0
	MCALL C5_LOG_CHAR
	POP TEMP
.ENDMACRO
.endif
.endif
