;-----------------------------------------------------------------------------------------------------------------------
;Файл распространяется под лицензией GPL-3.0-or-later, https://www.gnu.org/licenses/gpl-3.0.txt
;-----------------------------------------------------------------------------------------------------------------------
;12.06.2020	w5277c@gmail.com        Начало
;01.08.2020	w5277c@gmail.com        Разбиение на файлы
;27.10.2020	w5277c@gmail.com        Обновлена информация об авторских правах
;-----------------------------------------------------------------------------------------------------------------------
.ifdef DEF_C5_OUT_BYTE
.else
.set DEF_C5_OUT_BYTE = 1
.ifdef LOGGING_PORT

.include	"./conv/byte_to_hex.inc"
.include	"./core/io/out_char.inc"

;--------------------------------------------------------
C5_OUT_BYTE:
;--------------------------------------------------------
;Логирование байта
;IN: TEMP-байт
;--------------------------------------------------------
	PUSH TEMP
	PUSH TEMP_H
	PUSH TEMP_L

	MCALL BYTE_TO_HEX
	MOV TEMP,TEMP_H
	MCALL C5_OUT_CHAR
	MOV TEMP,TEMP_L
	MCALL C5_OUT_CHAR

	POP TEMP_L
	POP TEMP_H
	POP TEMP
	RET
.endif
.endif
