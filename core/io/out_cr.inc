;-----------------------------------------------------------------------------------------------------------------------
;Файл распространяется под лицензией GPL-3.0-or-later, https://www.gnu.org/licenses/gpl-3.0.txt
;-----------------------------------------------------------------------------------------------------------------------
;12.06.2020	w5277c@gmail.com        Начало
;01.08.2020	w5277c@gmail.com        Разбиение на файлы
;27.10.2020	w5277c@gmail.com        Обновлена информация об авторских правах
;-----------------------------------------------------------------------------------------------------------------------
.ifdef DEF_C5_OUT_CR
.else
.set DEF_C5_OUT_CR = 1
.ifdef LOGGING_PORT

.include	"./core/io/out_char.inc"

;--------------------------------------------------------
C5_OUT_CR:
;--------------------------------------------------------
;Перевод на новую строку
;--------------------------------------------------------
	PUSH TEMP
	LDI TEMP,0x0d
	MCALL C5_OUT_CHAR
	LDI TEMP,0x0a
	MCALL C5_OUT_CHAR
	POP TEMP
	RET
.endif
.endif
