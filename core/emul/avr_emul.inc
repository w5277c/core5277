;-----------------------------------------------------------------------------------------------------------------------
;Файл распространяется под лицензией GPL-3.0-or-later, https://www.gnu.org/licenses/gpl-3.0.txt
;-----------------------------------------------------------------------------------------------------------------------
;28.12.2020	w5277c@gmail.com			Начало
;29.12.2020	w5277c@gmail.com			Очень грубый набросок, вероятно будет сильно переделан или даже удален.
;-----------------------------------------------------------------------------------------------------------------------
.ifdef DEF_C5_AVREMUL
.else
.set DEF_C5_AVREMUL = 1

.include	"./conv/bitnum_to_num.inc"
.include	"./core/ram/ram_realloc.inc"

	.EQU	C5_AVREMUL_REGS_QNT					= 0x10			;
	.EQU	C5_AVREMUL_RAM_SIZE					= C5_AVREMUL_REGS_QNT

;---REGISTERS--------------------------------------------;Регистры
	.EQU	C5_AVREMUL_R16							= 0x00			;
	.EQU	C5_AVREMUL_R17							= 0x01			;
	.EQU	C5_AVREMUL_R18							= 0x02			;
	.EQU	C5_AVREMUL_R19							= 0x03			;
	.EQU	C5_AVREMUL_R20							= 0x04			;
	.EQU	C5_AVREMUL_R21							= 0x05			;
	.EQU	C5_AVREMUL_R22							= 0x06			;
	.EQU	C5_AVREMUL_R23							= 0x07			;
	.EQU	C5_AVREMUL_R24							= 0x08			;
	.EQU	C5_AVREMUL_R25							= 0x09			;
	.EQU	C5_AVREMUL_RXL							= 0x0a			;
	.EQU	C5_AVREMUL_RXH							= 0x0b			;
	.EQU	C5_AVREMUL_RYL							= 0x0c			;
	.EQU	C5_AVREMUL_RYH							= 0x0d			;
	.EQU	C5_AVREMUL_RZL							= 0x0e			;
	.EQU	C5_AVREMUL_RZH							= 0x0f			;

_AVREMUL_C5_PROCS:
	.dw	0x0000,C5_EXEC,C5_WAIT_2MS,C5_DISPATCHER_LOCK,C5_DISPATCHER_UNLOCK,\
			C5_SUSPEND

AVREMUL_TABLE1:
	CPC ACCUM,TEMP														;0000 01rd dddd rrrr
	RET
	SBC ACCUM,TEMP														;0000 10rd dddd rrrr
	RET
	ADD ACCUM,TEMP														;0000 11rd dddd rrrr
	RET
	RJMP AVREMUL_TABLE1_CPSE										;0001 00rd dddd rrrr
	NOP
	CP ACCUM,TEMP														;0001 01rd dddd rrrr
	RET
	SUB ACCUM,TEMP														;0001 10rd dddd rrrr
	RET
	ADC ACCUM,TEMP														;0001 11rd dddd rrrr
	RET
	AND ACCUM,TEMP														;0010 00rd dddd rrrr
	RET
	EOR ACCUM,TEMP														;0010 01rd dddd rrrr
	RET
	OR ACCUM,TEMP														;0010 10rd dddd rrrr
	RET
	MOV ACCUM,TEMP														;0010 11rd dddd rrrr
	RET
AVREMUL_TABLE1_CPSE:
	PUSH FLAGS
	CP ACCUM,TEMP
	BRNE PC+0x02
	ADIW X,0x02
	POP FLAGS
	RET
AVREMUL_TABLE2:
	CP ACCUM,TEMP														;0011 KKKK dddd KKKK (CPI)
	RET
	SBC ACCUM,TEMP														;0100 KKKK dddd KKKK (SBCI)
	RET
	SUB ACCUM,TEMP														;0101 KKKK dddd KKKK (SUBI)
	RET
	OR ACCUM,TEMP														;0110 KKKK dddd KKKK (ORI)
	RET
	AND ACCUM,TEMP														;0111 KKKK dddd KKKK (ANDI)
	RET
AVREMUL_TABLE3:
	COM ACCUM															;1001 010d dddd 0000
	RET
	NEG ACCUM															;1001 010d dddd 0001
	RET
	SWAP ACCUM															;1001 010d dddd 0010
	RET
	INC ACCUM															;1001 010d dddd 0011
	RET
	NOP																	;1001 010d dddd 0100	(reserved)
	RET
	ASR ACCUM															;1001 010d dddd 0101
	RET
	LSR ACCUM															;1001 010d dddd 0110
	RET
	ROR ACCUM															;1001 010d dddd 0111
	RET
	MOV TEMP,ACCUM														;1001 0100 Bbbb 1000 (set/clear sreg bit)
	ANDI TEMP,0x07
	MCALL BITNUM_TO_NUM
	PUSH TEMP
	COM TEMP
	ANDI FLAGS,TEMP
	POP TEMP
	SBRS ACCUM,0x03
	ORI FLAGS,TEMP
	RET


;--------------------------------------------------------
.MACRO _AVREMUL_ADD_Z
	LDI ZH,high(@0)
	LDI ZL,low(@0)
	ADD ZL,TEMP
	CLR TEMP
	ADC ZH,TEMP
.ENDMACRO
.MACRO _AVREMUL_GET_OPCODE
	MOV TEMP,TEMP_L
	ANDI TEMP,0x0f
.ENDMACRO
.MACRO _AVREMUL_GET_RD
	MOV TEMP_H,TEMP_L
	SWAP TEMP_H
	ANDI TEMP_H,0x0f
.ENDMACRO
.MACRO _AVREMUL_GET_K
	ANDI TEMP_L,0x0f
	SWAP TEMP
	ANDI TEMP,0xf0
	OR TEMP,TEMP_L
.ENDMACRO
.MACRO _AVREMUL_GET_REG_A
	ADD YL,TEMP_H
	CLR ACCUM
	ADC YH,ACCUM
	LDD ACCUM,Y+C5_AVREMUL_R16
	SUB YL,TEMP_H
	SBCI YH,0x00
.ENDMACRO
.MACRO _AVREMUL_SET_REG_A
	ADD YL,TEMP_H
	CLR TEMP
	ADC YH,TEMP
	STD Y+C5_AVREMUL_R16,TEMP
	SUB YL,TEMP_H
	SBCI YH,0x00
.ENDMACRO
.MACRO _AVREMUL_GET_REG_T
	ADD YL,TEMP_L
	CLR TEMP
	ADC YH,TEMP
	LDD TEMP,Y+C5_AVREMUL_R16
	SUB YL,TEMP_L
	SBCI YH,0x00
.ENDMACRO
.MACRO _AVREMUL_ICALL
	STS SREG,FLAGS
	ICALL
	LDS FLAGS,SREG
.ENDMACRO


;--------------------------------------------------------
AVREMUL_INIT:
;--------------------------------------------------------
;IN:X - адрес начала программы расположенной в RAM
;TEMP_H - размер программы, TEMP_L - размер выделяемой
;памяти.
;В сумме не должно превышать 256-C5_AVREMUL_REGS_QNT байт
;--------------------------------------------------------
	LDI ACCUM,C5_AVREMUL_RAM_SIZE
	ADD ACCUM,TEMP
	MCALL C5_RAM_REALLOC
	MOV YH,ZH
	MOV YL,ZL
	MCALL C5_READY
	RJMP AVREMUL_EXEC

AVREMUL_EXEC_RW_ZA_BY_T:
	;Читаю или записываю согласно биту s
	BRTS PC+0x02
	LD ACCUM,Z
	BRTC PC+0x02
	ST Z,ACCUM
	_AVREMUL_SET_REG_A
	RJMP AVREMUL_EXEC
;--------------------------------------------------------
AVREMUL_EXEC:
;--------------------------------------------------------
;X - PC, FLAGS - sreg
;--------------------------------------------------------
	LD TEMP_H,X+
	LD TEMP_L,X+
	CPI TEMP_H,00000000b
	BRNE AVREMUL_EXEC_L0
	CPI TEMP_L,0x00
	BREQ AVREMUL_EXEC
	;CORE PROC CALLS
	;...

AVREMUL_EXEC_L0:
	;00cc ccrd dddd rrrr		2-operand instructions
	;1111 1100 0000 0000
	MOV TEMP,TEMP_H
	ANDI TEMP,11111100b
	CPI TEMP,0x04
	BRCS AVREMUL_EXEC_UNSUPPORTED
	CPI TEMP,0x2c+0x01
	BRCC AVREMUL_EXEC_L1
	;CPC/CP,SBC/SUB,ADD/ADC,CPSE,AND,EOR,OR,MOV
		;Получаю адрес процедуры
		MOV TEMP,TEMP_H
		ANDI TEMP,0x3c
		ROL TEMP														;?
		_AVREMUL_ADD_Z AVREMUL_TABLE1
		_AVREMUL_GET_RD
		ANDI TEMP_L,0x0f
		_AVREMUL_GET_REG_A
		_AVREMUL_GET_REG_T
		_AVREMUL_ICALL
		_AVREMUL_SET_REG_A
		RJMP AVREMUL_EXEC
AVREMUL_EXEC_L1:
	;0011 kkkk dddd kkkk
	;1111 0000b,0x30-0x70
	MOV TEMP,TEMP_H
	ANDI TEMP,11110000b
	CPI TEMP,0x30
	BRCS AVREMUL_EXEC_UNSUPPORTED
	CPI TEMP,0x70+0x01
	BRCC AVREMUL_EXEC_L2
		;SBCI/SUBI,ORI,ANDI
		;Получаю адрес процедуры
		MOV TEMP,TEMP_H
		SWAP TEMP
		SUBI TEMP,0x03
		ROL TEMP															;?
		_AVREMUL_ADD_Z AVREMUL_TABLE2
		MOV TEMP,TEMP_H
		_AVREMUL_GET_RD
		_AVREMUL_GET_K
		_AVREMUL_GET_REG_A
		_AVREMUL_ICALL
		_AVREMUL_SET_REG_A
		RJMP AVREMUL_EXEC
AVREMUL_EXEC_L2:
	;1101 0000b,0xd0
	;10k0 kksd dddd ykkk
	MOV TEMP,TEMP_H
	ANDI TEMP,11010000b
	CPI TEMP,0xd0
	BRCS AVREMUL_EXEC_UNSUPPORTED
	BRNE AVREMUL_EXEC_L3
		;LDD/STD (Z+k,Y+k)
		BLD TEMP_H,0x01
		;Получаю номер регистра и константу
		MOV ACCUM,TEMP_H
		_AVREMUL_GET_RD
		MOV TEMP,TEMP_L
		ANDI TEMP,0x07
		LSL ACCUM
		ANDI ACCUM,0x58
		OR TEMP,ACCUM
		LSL TEMP
		ANDI TEMP,0x5e
		LSR ACCUM
		ANDI ACCUM,40
		OR TEMP,ACCUM
		_AVREMUL_GET_REG_A
		;получаю значене регистров и увеличиваю на константу
		LDD ZH,Y+C5_AVREMUL_RZH
		LDD ZL,Y+C5_AVREMUL_RZL
		ADD ZL,TEMP
		CLR TEMP
		ADC ZH,TEMP
		RJMP AVREMUL_EXEC_RW_ZA_BY_T
AVREMUL_EXEC_L3:
	;1111 1100,0xd0
	;1001 00sd dddd oooo,
	MOV TEMP,TEMP_H
	ANDI TEMP,11111100b
	CPI TEMP,0x90
	BRCS AVREMUL_EXEC_UNSUPPORTED
	BRNE AVREMUL_EXEC_L4
		;Получаю номер регистра
		BLD TEMP_H,0x01
		_AVREMUL_GET_RD
		_AVREMUL_GET_OPCODE
		CPI TEMP,0x00
		BRNE AVREMUL_EXEC_L3_2
			;LDS/STS
			;Получаю константу
			LD ZH,X+
			LD ZL,X+
			_AVREMUL_GET_REG_A
			RJMP AVREMUL_EXEC_RW_ZA_BY_T
AVREMUL_EXEC_L3_2:
		MOV TEMP_L,TEMP
		ANDI TEMP_L,0x07
		CPI TEMP_L,0x04
		BRCC AVREMUL_EXEC_L3_3
			;LD/ST Z+/Y+/-Z/-Y
			LDI TEMP_L,0x02
			SBRS TEMP,0x03
			MOV TEMP_L,0x00
			SUB YL,TEMP_L
			SBCI YH,0x00
			LDD ZH,Y+C5_AVREMUL_RZH
			LDD ZL,Y+C5_AVREMUL_RZL
			_AVREMUL_GET_REG_A
			LSR TEMP
			BRCC AVREMUL_EXEC_L3_2_MINUS
			BRTS PC+0x02
			LD ACCUM,Z+
			BRTC PC+0x02
			ST Z+,ACCUM
			RJMP AVREMUL_EXEC_L3_2_END
AVREMUL_EXEC_L3_2_MINUS:
			BRTS PC+0x02
			LD ACCUM,-Z
			BRTC PC+0x02
			ST -Z,ACCUM
AVREMUL_EXEC_L3_2_END:
			STD Y+C5_AVREMUL_RZH,ZH
			STD Y+C5_AVREMUL_RZL,ZL
			ADD YL,TEMP_L
			CLR TEMP_L
			ADC YH,TEMP_L
			_AVREMUL_SET_REG_A
			RJMP AVREMUL_EXEC_RW_ZA_BY_T
AVREMUL_EXEC_L3_3:
			;LPM Z/Z+	;TODO добавлять адрес по которому расположена программа?
			SBRC TEMP,0x03
			RJMP AVREMUL_EXEC_L3_4
			BRTS AVREMUL_EXEC_UNSUPPORTED
			LDD ZH,Y+C5_AVREMUL_RZH
			LDD ZL,Y+C5_AVREMUL_RZL
			_AVREMUL_GET_REG_A
			SBRC TEMP,0x00
			LD ACCUM,Z
			SBRS TEMP,0x00
			LD ACCUM,Z+
			SBRS TEMP,0x00
			LD TEMP,Z+
			STD Y+C5_AVREMUL_RZH,ZH
			STD Y+C5_AVREMUL_RZL,ZL
			_AVREMUL_SET_REG_A
			RJMP AVREMUL_EXEC
AVREMUL_EXEC_L3_4:
			;LD/ST X/X+/-X
			CPI TEMP,0x0f
			BREQ AVREMUL_EXEC_L3_5
			LDD ZH,Y+C5_AVREMUL_RXH
			LDD ZL,Y+C5_AVREMUL_RXL
			_AVREMUL_GET_REG_A
			ANDI TEMP,0x03
			BRNE AVREMUL_EXEC_L3_4_1
			BRTS PC+0x02
			LD ACCUM,Z
			BRTC PC+0x02
			ST Z,ACCUM
			RJMP AVREMUL_EXEC_L3_4_3
AVREMUL_EXEC_L3_4_1:
			SBRS TEMP,0x00
			RJMP AVREMUL_EXEC_L3_4_2
			BRTS PC+0x02
			LD ACCUM,Z+
			BRTC PC+0x02
			ST Z+,ACCUM
			RJMP AVREMUL_EXEC_L3_4_3
AVREMUL_EXEC_L3_4_2:
			BRTS PC+0x02
			LD ACCUM,-Z
			BRTC PC+0x02
			ST -Z,ACCUM
AVREMUL_EXEC_L3_4_3:
			_AVREMUL_SET_REG_A
			STD Y+C5_AVREMUL_RZH,ZH
			STD Y+C5_AVREMUL_RZL,ZL
			RJMP AVREMUL_EXEC
AVREMUL_EXEC_L3_5:
			;POP/PUSH
			_AVREMUL_GET_REG_A
			BRTS PC+0x02
			POP ACCUM
			BRTC PC+0x02
			PUSH ACCUM
			_AVREMUL_SET_REG_A
			RJMP AVREMUL_EXEC
AVREMUL_EXEC_L4:
	;1001 010d dddd cccc
	MOV TEMP,TEMP_H
	ANDI TEMP,11111110b
	CPI TEMP,0x94
	BRCS AVREMUL_EXEC_UNSUPPORTED
	BRNE AVREMUL_EXEC_L5
		;COM,NEG,SWAP,INC,ASR,LSR,ROR,SEx/CLx
		;Получаю адрес процедуры
		MOV TEMP,TEMP_L
		ANDI TEMP,0x07
		ROL TEMP															;?
		_AVREMUL_ADD_Z AVREMUL_TABLE3
		_AVREMUL_GET_RD
		_AVREMUL_GET_REG_A
		_AVREMUL_ICALL
		_AVREMUL_SET_REG_A
		RJMP AVREMUL_EXEC
AVREMUL_EXEC_L5:
	;TODO ...

AVREMUL_EXEC_L6:
	;TODO ...

AVREMUL_EXEC_L7:
	;1110 kkkk dddd kkkk
	MOV TEMP,TEMP_H
	ANDI TEMP,11110000b
	CPI TEMP,0xe0
	BRCS AVREMUL_EXEC_UNSUPPORTED
	BRNE AVREMUL_EXEC_L8
		;LDI
		MOV TEMP,TEMP_H
		_AVREMUL_GET_RD
		_AVREMUL_GET_K
		_AVREMUL_SET_REG_T
		RJMP AVREMUL_EXEC
AVREMUL_EXEC_L8:
	;1111 0Boo oooo obbb
	MOV TEMP,TEMP_H
	ANDI TEMP,11111000b
	CPI TEMP,0xf0
	BRCS AVREMUL_EXEC_UNSUPPORTED
	BRNE AVREMUL_EXEC_L9
		;BREQ,BRNE,BRCS,BRCC...
		;Получаю номер регистра
		MOV TEMP,TEMP_L
		ANDI TEMP,0x07
		MCALL BITNUM_TO_NUM
		BLD TEMP_H,0x02
		LSR TEMP_H
		ROR TEMP_L
		LSR TEMP_H
		ROR TEMP_L
		ANDI TEMP_L,0xfe
		CLR TEMP_H
		MOV ACCUM,FLAGS
		AND ACCUM,TEMP
		BREQ AVREMUL_EXEC_L8_LO
		BRTS PC+0x02
		ADD XL,TEMP
		ADC XH,TEMP_H
		RJMP AVREMUL_EXEC
AVREMUL_EXEC_L8_LO:
		BRTC PC+0x02
		ADD XL,TEMP
		ADC XH,TEMP_H
		RJMP AVREMUL_EXEC
AVREMUL_EXEC_L9:
