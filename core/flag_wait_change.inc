;-----------------------------------------------------------------------------------------------------------------------
;Файл распространяется под лицензией GPL-3.0-or-later, https://www.gnu.org/licenses/gpl-3.0.txt
;-----------------------------------------------------------------------------------------------------------------------
;07.10.2019  w5277c@gmail.com        Начало
;04.08.2020  w5277c@gmail.com        Разбиение на файлы
;27.10.2020  w5277c@gmail.com        Обновлена информация об авторских правах
;-----------------------------------------------------------------------------------------------------------------------
.ifdef DEF_C5_FLAG_WAIT_CHANGE
.else
.set DEF_C5_FLAG_WAIT_CHANGE = 1

.if REPORT_INCLUDES == 0x01
.message "included C5_FLAG_WAIT_CHANGE"
.endif

.include	"./inc/core/flag_get.inc"
.include	"./inc/core/flag_wait_lo.inc"
.include	"./inc/core/flag_wait_hi.inc"

;--------------------------------------------------------
C5_FLAG_WAIT_CHANGE:
;--------------------------------------------------------
;Ожидание изменения состояния флага
;IN:TEMP - номер флага(0-63)
;--------------------------------------------------------
	MCALL C5_FLAG_GET											;TODO Что если в перрывании поменяется флаг?
	BRNE PC+0x03														;TODO Может блокировать прерывания?
	MJMP C5_FLAG_WAIT_HI
	MJMP C5_FLAG_WAIT_LO
.endif
