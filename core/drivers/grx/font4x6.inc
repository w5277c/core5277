;-----------------------------------------------------------------------------------------------------------------------
;Файл распространяется под лицензией GPL-3.0-or-later, https://www.gnu.org/licenses/gpl-3.0.txt
;-----------------------------------------------------------------------------------------------------------------------
;11.06.2021	w5277c@gmail.com			Начало
;-----------------------------------------------------------------------------------------------------------------------
;Шрифт 4х6 точек, KOI8-R, размер таблицы (256-32)*2=448B
;-----------------------------------------------------------------------------------------------------------------------
.ifdef DEF__DRV_FONT4X6
.else
.set DEF__DRV_FONT4X6 = 1

FONT4X6_DATA:
	.dw 	b0000000000000000,b0010010010000010,b0101101000000000,b0101111101111101,b0011110011011110,b0101001010100101\	;" !'#$%"
			b0110110111101011,b0001001000000000,b0001010010010001,b0100010010010100,b0101010101000000,b0000010111010000\	;"&'()*+"
			b1000000000001010,b0000001110000000,b0000000000000001,b0001001010100100,b0111101101101111,b0001001001001001\	;",-./01"
			b0111001111100111,b0111001011001111,b0101101111001001,b0111100111001111,b0111100111101111,b0111001001001001\	;"234567"
			b0111101111101111,b0111101111001111,b0000010000010000,b0000001000001010,b0001010100010001,b0000111000111000\	;"89:;<="
			;TODO
.endif
