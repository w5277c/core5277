;-----------------------------------------------------------------------------------------------------------------------
;Файл распространяется под лицензией GPL-3.0-or-later, https://www.gnu.org/licenses/gpl-3.0.txt
;-----------------------------------------------------------------------------------------------------------------------
;11.06.2021	w5277c@gmail.com			Начало
;-----------------------------------------------------------------------------------------------------------------------
;Заголовочный файл видео драйверов(LCD контроллеров и прочего)
;-----------------------------------------------------------------------------------------------------------------------
.ifdef DEF__DRV__VIDEO
.else
.set DEF__DRV__VIDEO = 1

	;---TXT-MODES(BITS)---
	.EQU	DRV_GRX_MODE_TXT1B							= 0x00	;Текст, монохромный
;	.EQU	DRV_GRX_MODE_TXT3B							= 0x01	;Текст, 8 цветов
;	.EQU	DRV_GRX_MODE_TXT4B							= 0x02	;Текст, 16 цветов (4б, 1б на каждый цвет, 1 бит яркости)
	;---GRX-MODES(BITS)---
	.EQU	DRV_GRX_MODE_GRX1B							= 0x00	;Графический, монохромный (1б)
;	.EQU	DRV_GRX_MODE_GRX3B							= 0x01	;Графический, 8цветов (3б)
;	.EQU	DRV_GRX_MODE_GRX4B							= 0x02	;Графический, 16 цветов (4б, 1б на каждый цвет, 1 бит яркости)
;	.EQU	DRV_GRX_MODE_GRX6B							= 0x03	;Графический, 64 цвета (6б, 2б на каждый цвет)
;	.EQU	DRV_GRX_MODE_GRX9B							= 0x04	;Графический, 512 цветов (9б, 3б на каждый цвет)
;	.EQU	DRV_GRX_MODE_GRX12B							= 0x05	;Графический, 4К цветов (12б, 4б на каждый цвет)
;	.EQU	DRV_GRX_MODE_GRX15B							= 0x06	;Графический, 32К цветов (15б, 5б на каждый цвет)
;	.EQU	DRV_GRX_MODE_GRX24B							= 0x07	;Графический, 16М цветов (24б, 8б на каждый цвет)
;	.EQU	DRV_GRX_MODE_GRX30B							= 0x08	;Графический, 1Г цветов (30б, 10б на каждый цвет)

	;---OPERATIONS---
	.EQU	DRV_GRX_OP_SET_MODE							= 0x00	;Задать текущий графический или текстовый режим
	.EQU	DRV_GRX_OP_SET_FONT							= 0x01	;Задать фонт
	.EQU	DRV_GRX_OP_GET_SIZE							= 0x02	;Получить размер экрана
	.EQU	DRV_GRX_OP_SET_XY								= 0x03	;Задать позицию
	.EQU	DRV_GRX_OP_SET_TEXT							= 0x04	;Вывести текст с текущей позиции

	;---RESULTS---
	.EQU	DRV_GRX_RESULT_OK								= 0x00
	.EQU	DRV_GRX_RESULT_UNSUPPORTED					= 0x01
	.EQU	DRV_GRX_RESULT_INVALID						= 0x02	;Не корректная опреация или ее параметр с учетом выбранных настроек


.endif
