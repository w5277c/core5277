;-----------------------------------------------------------------------------------------------------------------------
;Файл распространяется под лицензией GPL-3.0-or-later, https://www.gnu.org/licenses/gpl-3.0.txt
;-----------------------------------------------------------------------------------------------------------------------
;12.01.2023	konstantin@5277.ru			Начало
;-----------------------------------------------------------------------------------------------------------------------
.ifdef DEF__DRV_FS
.else
.set DEF__DRV_FS = 1
	;---OPERATIONS---
	.EQU	DRV_FS_OP_FORMAT						= 0x01			;Создать FS
	;---
	.EQU	DRV_FS_OP_INFO							= 0x10			;Считать блок с информацией об элементе
	.EQU	DRV_FS_OP_DELETE						= 0x11			;Удалить элемент(без рекурсии, пустую директорию)
	.EQU	DRV_FS_OP_RESTORE						= 0x12			;Восстановить элемент
	.EQU	DRV_FS_OP_RENAME						= 0x13			;Переименовать
	.EQU	DRV_FS_OP_MOVE							= 0x14			;Переместить
	.EQU	DRV_FS_OP_OPTIONS						= 0x15			;Задать параметры элементу
	;---
	.EQU	DRV_FS_OP_MD							= 0x20			;Создать директорию
	.EQU	DRV_FS_OP_NEXT							= 0x21			;Получить следующий элемент директории
	;---
	.EQU	DRV_FS_OP_MF							= 0x30			;Создать файл
	.EQU	DRV_FS_OP_READ							= 0x31			;Считать данные с файла
	.EQU	DRV_FS_OP_WRITE						= 0x32			;Записать данные в файл
	.EQU	DRV_FS_OP_APPEND						= 0x33			;Добавить данные в файл
	.EQU	DRV_FS_OP_FLUSH						= 0x34			;Сбросить данные на диск

;	.EQU	DRV_FS_CMD_DISK_PGET					= 0x01			;Считать параметр
;	.EQU	DRV_FS_CMD_DISK_PSET					= 0x02			;Записать параметр
;	.EQU	DRV_FS_CMD_DISK_BREAD				= 0x03			;Считать данные с блока
;	.EQU	DRV_FS_CMD_DISK_BWRITE				= 0x04			;Записать данные в блок
;	.EQU	DRV_FS_CMD_DISK_BVERIFY				= 0x05			;Проверить данные в блоке
.endif
