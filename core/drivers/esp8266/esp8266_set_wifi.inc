;-----------------------------------------------------------------------------------------------------------------------
;Файл распространяется под лицензией GPL-3.0-or-later, https://www.gnu.org/licenses/gpl-3.0.txt
;-----------------------------------------------------------------------------------------------------------------------
;01.10.2021	w5277c@gmail.com			Код вынесен из esp8266.inc
;-----------------------------------------------------------------------------------------------------------------------

.ifdef DEF_DRIVER_ESP8266_SET_WIFI
.else
.set DEF_DRIVER_ESP8266_SET_WIFI = 1

.include	"./prim/common.inc"
.include	"./prim/prim_mov.inc"
.include	"./prim/prim_cpi.inc"

_DRV_ESP8266_AT_SET_WIFI1:					.db "AT+CWJAP_CUR=",0x22,0x00,0x00;+APN+
_DRV_ESP8266_AT_SET_WIFI2:					.db 0x22,",",0x22,0x00;+PASSWORD+
_DRV_ESP8266_AT_SET_WIFI3:					.db 0x22,0x0d,0x0a,0x00
_DRV_ESP8266_AT_GET_IP:						.db "AT+CIFSR",0x0d,0x0a,0x00,0x00

_DRV_ESP8266_WIFI_CONNECT_TIMEOUT:		.db 0x01,0xc9,0xc3,0x80	;TIME VAR = 30 сек.

;--------------------------------------------------------
_DRV_ESP8266__OP_SET_WIFI:
;--------------------------------------------------------
;Задаем подключение к WI-FI точке доступа
;IN; Y-адрес выделенной памяти
;X-адрес на имя AP, Z-адрес на пароль
;OUT:TEMP_H-RESULT
;--------------------------------------------------------
	PUSH_X
	PUSH_Z
	PUSH TEMP_EH
	PUSH TEMP_EL
	PUSH TEMP_L
	PUSH TEMP
	PUSH ACCUM

	PUSH_Z
	PUSH_X
	MOVW XL,YL
	ADIW XL,_DRV_ESP8266_BUFFER
	LDI_Z _DRV_ESP8266_AT_SET_WIFI1|0x8000
	MCALL STR_TO_RAM
	POP_Z
	MCALL STR_TO_RAM
	LDI_Z _DRV_ESP8266_AT_SET_WIFI2|0x8000
	MCALL STR_TO_RAM
	POP_Z
	MCALL STR_TO_RAM
	LDI_Z _DRV_ESP8266_AT_SET_WIFI3|0x8000
	MCALL STR_TO_RAM
	SBIW XL,_DRV_ESP8266_BUFFER
	SUB XL,YL
	MOV TEMP_EH,XL
	MOVW XL,YL
	ADIW XL,_DRV_ESP8266_BUFFER
	MOVW ZL,XL
	LDI TEMP_EL,(_DRV_ESP8266_BUFFER_SIZE-0x01)
	LDI TEMP_H,high(3000/2)
	LDI TEMP_L,low(3000/2)
.ifdef _DRV_ESP8266__LOG_REQV
	MCALL _DRV_ESP8266__LOG_REQV
.endif
	LDD TEMP,Y+_DRV_ESP8266_UART_DRV_ID
	MCALL C5_EXEC
	;Если ответ не получен - выходим с ошибкой
	CPI TEMP_H,DRV_UART_ST_READY
	BREQ PC+0x02
	RJMP __DRV_ESP8266__OP_SET_WIFI__FAIL
	CPI TEMP_L,0x00
	BRNE PC+0x02
	RJMP __DRV_ESP8266__OP_SET_WIFI__FAIL
.ifdef _DRV_ESP8266__LOG_RESP
	MCALL _DRV_ESP8266__LOG_RESP
.endif
	;Считываем сообщения ожидая "OK" в течении 15 секунд
	LDI TEMP,_DRV_ESP8266_TIME_START
	MCALL C5_TIME32_MARK
	RJMP __DRV_ESP8266__OP_SET_WIFI__FIRST_READ_SKIP
__DRV_ESP8266__OP_SET_WIFI__READ_LOOP:

	;Только читаем
	MOVW XL,YL
	ADIW XL,_DRV_ESP8266_BUFFER
	MOVW ZL,XL
	LDI TEMP_EH,0x00
	LDI TEMP_EL,(_DRV_ESP8266_BUFFER_SIZE-0x01)
	LDI TEMP_H,high(3000/2)
	LDI TEMP_L,low(3000/2)
	LDD TEMP,Y+_DRV_ESP8266_UART_DRV_ID
	MCALL C5_EXEC
	CPI TEMP_H,DRV_UART_ST_READY
	BREQ PC+0x02
	RJMP __DRV_ESP8266__OP_SET_WIFI__NO_ANSWER
	CPI TEMP_L,0x00
	BRNE PC+0x02
	RJMP __DRV_ESP8266__OP_SET_WIFI__NO_ANSWER
.ifdef _DRV_ESP8266__LOG_RESP
	MCALL _DRV_ESP8266__LOG_RESP
.endif
__DRV_ESP8266__OP_SET_WIFI__FIRST_READ_SKIP:
	ADD ZL,TEMP_L
	ADC ZH,C0x00
	ST Z,C0x00

	LDI_Z _DRV_ESP8266_AT_RESP_OK|0x8000
	MCALL STR_FIND
	CPI TEMP_H,0xff
	BRNE __DRV_ESP8266__OP_SET_WIFI__SUCCESS
	LDI_Z _DRV_ESP8266_AT_RESP_ERROR|0x8000
	MCALL STR_FIND
	CPI TEMP_H,0xff
	BRNE __DRV_ESP8266__OP_SET_WIFI__FAIL
	LDI_Z _DRV_ESP8266_AT_RESP_FAIL|0x8000
	MCALL STR_FIND
	CPI TEMP_H,0xff
	BRNE __DRV_ESP8266__OP_SET_WIFI__FAIL

__DRV_ESP8266__OP_SET_WIFI__NO_ANSWER:
	LDI ACCUM,PRIM_INT
	LDI TEMP_H,_DRV_ESP8266_TIME_DELTA
	LDI TEMP_L,_DRV_ESP8266_TIME_START
	MCALL PRIM_MOV
	LDI TEMP,_DRV_ESP8266_TIME_DELTA
	MCALL C5_TIME32_DELTA
	LDI_Z _DRV_ESP8266_WIFI_CONNECT_TIMEOUT|0x8000
	MCALL PRIM_CPI
	BRCC PC+0x02
	RJMP __DRV_ESP8266__OP_SET_WIFI__READ_LOOP
	RJMP __DRV_ESP8266__OP_SET_WIFI__FAIL
__DRV_ESP8266__OP_SET_WIFI__SUCCESS:

	;GET IP
	LDI_Z _DRV_ESP8266_AT_GET_IP|0x8000
	MOVW XL,YL
	ADIW XL,_DRV_ESP8266_BUFFER
	MCALL STR_TO_RAM
	SBIW XL,_DRV_ESP8266_BUFFER
	SUB XL,YL
	MOV TEMP_H,XL
	MOVW ZL,YL
	ADIW ZL,_DRV_ESP8266_BUFFER
	MCALL _DRV_ESP8266__OP_RAW
	LDI TEMP_H,DRV_RESULT_OK
	RJMP __DRV_ESP8266__OP_SET_WIFI__END
__DRV_ESP8266__OP_SET_WIFI__FAIL:
	LDI TEMP_H,DRV_RESULT_ERROR
__DRV_ESP8266__OP_SET_WIFI__END:

	POP ACCUM
	POP TEMP
	POP TEMP_L
	POP TEMP_EL
	POP TEMP_EH
	POP_Z
	POP_X
	RET
.endif
