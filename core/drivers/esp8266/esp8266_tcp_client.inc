;-----------------------------------------------------------------------------------------------------------------------
;Файл распространяется под лицензией GPL-3.0-or-later, https://www.gnu.org/licenses/gpl-3.0.txt
;-----------------------------------------------------------------------------------------------------------------------
;10.09.2022	konstantin@5277.ru			Начало
;-----------------------------------------------------------------------------------------------------------------------

.ifdef DEF_DRIVER_ESP8266_TCP_CLIENT
.else
.set DEF_DRIVER_ESP8266_TCP_CLIENT = 1

;_DRV_ESP8266_AT_SET_MULTIPLE_CONNS:		.db "AT+CIPMUX=1",0x0d,0x0a,0x00
;_DRV_ESP8266_AT_SET_RECV_MODE:			.db "AT+CIPRECVMODE=0",0x0d,0x0a,0x00,0x00
;_DRV_ESP8266_AT_CREATE_TCP_SERVER:		.db "AT+CIPSERVER=1,",0x00;+PORT+END
;_DRV_ESP8266_AT_SET_SERVER_TIMEOUT:		.db "AT+CIPSTO=5",0x0d,0x0a,0x00

;--------------------------------------------------------
_DRV_ESP8266__OP_TCP_CLIENT:
;--------------------------------------------------------
;Активируем TCP клиент
;IN: TEMP_H/L-TCP порт, ....
;OUT:TEMP_H-RESULT
;--------------------------------------------------------
;TODO
	RET
.endif
