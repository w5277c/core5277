;-----------------------------------------------------------------------------------------------------------------------
;Файл распространяется под лицензией GPL-3.0-or-later, https://www.gnu.org/licenses/gpl-3.0.txt
;-----------------------------------------------------------------------------------------------------------------------
;29.04.2021	w5277c@gmail.com			Начало
;-----------------------------------------------------------------------------------------------------------------------
.ifdef DEF_DRIVER_FS_MD
.else
.set DEF_DRIVER_FS_MD = 1

.include "./str/str_len.inc"
.include	"./core/drivers/fs/_fs_name_check.inc"
.include	"./core/drivers/fs/_fs_get_removed_item.inc"
.include	"./mem/ram_fill.inc"
.include	"./mem/ram_copy.inc"

;--------------------------------------------------------
_DRV_FS_OP_MD:
;--------------------------------------------------------
;Создаем директорию
;IN: Y-адрес на переменные,X-RAM адрес на название
;директории, TEMP_H/L-родительский элемент
;OUT: FLAGS-результат DRV_RESULT_..., TEMP_H/L-ид нового
;элемента
;--------------------------------------------------------
	PUSH_X
	PUSH_Z
	PUSH TEMP_EH
	PUSH TEMP_EL
	PUSH LOOP_CNTR
	PUSH ACCUM

	;Проверка имени
	MCALL STR_LEN
	MOV LOOP_CNTR,TEMP
	MCALL _DRV_FS_NAME_CHECK
	CPI TEMP,DRV_RESULT_OK
	BREQ PC+0x02
	RJMP _DRV_FS_OP_MD__END

	;Проверка родителя
	MCALL _DRV_FS_ITEM_READ
	CPI TEMP,DRV_RESULT_OK
	BREQ PC+0x02
	RJMP _DRV_FS_OP_MD__END
	LDD ACCUM,Y+_DRV_FS_ITEM_BUFFER+DRV_FS_ITEM_OPT
	MOV TEMP,ACCUM
	ANDI TEMP,0x0f
	CPI TEMP,DRV_FS_TYPE_DIR
	LDI TEMP,DRV_RESULT_INVALID_RESOURCE
	BREQ PC+0x02
	RJMP _DRV_FS_OP_MD__END
	LDI TEMP,DRV_RESULT_READ_ONLY
	SBRC ACCUM,DRV_FS_OPT_RO
	RJMP _DRV_FS_OP_MD__END

	MOV TEMP_EH,TEMP_H
	MOV TEMP_EL,TEMP_L
	;Получаю номер последнего занятого элемента
	LDI_T16 0x0000
	MCALL _DRV_FS_ITEM_READ
	CPI TEMP,DRV_RESULT_OK
	BREQ PC+0x02
	RJMP _DRV_FS_OP_MD__END
	LDD TEMP_H,Y+_DRV_FS_ITEM_BUFFER+DRV_FS_ROOT_LAST_ITEM+0x00
	LDD TEMP_L,Y+_DRV_FS_ITEM_BUFFER+DRV_FS_ROOT_LAST_ITEM+0x01
	LDD TEMP,Y+_DRV_FS_ITEM_BUFFER+DRV_FS_ROOT_ROOT_BLKS+0x00
	CP TEMP_H,TEMP
	BRNE PC+0x04
	LDD TEMP,Y+_DRV_FS_ITEM_BUFFER+DRV_FS_ROOT_ROOT_BLKS+0x01
	CP TEMP_L,TEMP
	BREQ _DRV_FS_OP_MD__GET_REMOVED_ITEM
	;Есть свободный элемент
	LDI TEMP,0x01
	ADD TEMP_L,TEMP
	ADC TEMP_H,C0x00
	LDI ACCUM,0x00
	RJMP _DRV_FS_OP_MD__GOT_ITEM_ID
_DRV_FS_OP_MD__GET_REMOVED_ITEM:
	;TODO проверить
	LDI_T16 0x0001
	MCALL _DRV_FS_GET_REMOVED_ITEM
	CPI TEMP,DRV_RESULT_OK
	BREQ PC+0x02
	RJMP _DRV_FS_OP_MD__END
	LDI ACCUM,0x01
_DRV_FS_OP_MD__GOT_ITEM_ID:

	PUSH_X
	PUSH LOOP_CNTR
	MOVW XL,YL
	ADIW XL,_DRV_FS_ITEM_BUFFER
	LDI TEMP,0x00
	LDI LOOP_CNTR,DRV_FS_ITEM_SIZE
	MCALL RAM_FILL
	POP LOOP_CNTR
	POP_X
	STD Y+_DRV_FS_ITEM_BUFFER+DRV_FS_ITEM_PARENT_ID+0x00,TEMP_EH
	STD Y+_DRV_FS_ITEM_BUFFER+DRV_FS_ITEM_PARENT_ID+0x01,TEMP_EL
	PUSH_T16
	PUSH ACCUM
	LDD TEMP,Y+_DRV_FS_RTC_DRV_ID
	LDI FLAGS,DRV_RTC_GET_TIMESTAMP
	MCALL C5_EXEC
	POP ACCUM
	CPI TEMP,DRV_RESULT_OK
	BREQ PC+0x04
	POP_T16
	RJMP _DRV_FS_OP_MD__END
	STD Y+_DRV_FS_ITEM_BUFFER+DRV_FS_ITEM_CTIME+0x00,TEMP_EH
	STD Y+_DRV_FS_ITEM_BUFFER+DRV_FS_ITEM_CTIME+0x01,TEMP_EL
	STD Y+_DRV_FS_ITEM_BUFFER+DRV_FS_ITEM_CTIME+0x02,TEMP_H
	STD Y+_DRV_FS_ITEM_BUFFER+DRV_FS_ITEM_CTIME+0x03,TEMP_L
	STD Y+_DRV_FS_ITEM_BUFFER+DRV_FS_ITEM_ETIME+0x00,TEMP_EH
	STD Y+_DRV_FS_ITEM_BUFFER+DRV_FS_ITEM_ETIME+0x01,TEMP_EL
	STD Y+_DRV_FS_ITEM_BUFFER+DRV_FS_ITEM_ETIME+0x02,TEMP_H
	STD Y+_DRV_FS_ITEM_BUFFER+DRV_FS_ITEM_ETIME+0x03,TEMP_L
	POP_T16
	LDI TEMP,DRV_FS_TYPE_DIR
	STD Y+_DRV_FS_ITEM_BUFFER+DRV_FS_ITEM_OPT,TEMP

	MOVW ZL,XL
	MOVW XL,YL
	ADIW XL,_DRV_FS_ITEM_BUFFER+DRV_FS_ITEM_NAME
	LDI LOOP_CNTR,0x0c
	MCALL STRN_COPY

	MCALL _DRV_FS_ITEM_WRITE
	CPI TEMP,DRV_RESULT_OK
	BRNE _DRV_FS_OP_MD__END

	PUSH_T32
	LDI_T32 0x00000000
	MCALL _DRV_FS_BLOCK_READ
	POP_T32
	CPI TEMP,DRV_RESULT_OK
	BRNE _DRV_FS_OP_MD__END
	STD Y+_DRV_FS_ITEM_BUFFER+DRV_FS_ROOT_ETIME+0x00,TEMP_EH
	STD Y+_DRV_FS_ITEM_BUFFER+DRV_FS_ROOT_ETIME+0x01,TEMP_EL
	STD Y+_DRV_FS_ITEM_BUFFER+DRV_FS_ROOT_ETIME+0x02,TEMP_H
	STD Y+_DRV_FS_ITEM_BUFFER+DRV_FS_ROOT_ETIME+0x03,TEMP_L
	CPI ACCUM,0x00
	BRNE _DRV_FS_OP_MD__REWRITEN_EL
	LDI ACCUM,0x01
	LDD TEMP,Y+_DRV_FS_ITEM_BUFFER+DRV_FS_ROOT_LAST_ITEM+0x01
	ADD TEMP,ACCUM
	STD Y+_DRV_FS_ITEM_BUFFER+DRV_FS_ROOT_LAST_ITEM+0x01,TEMP
	LDD TEMP,Y+_DRV_FS_ITEM_BUFFER+DRV_FS_ROOT_LAST_ITEM+0x00
	ADC TEMP,C0x00
	STD Y+_DRV_FS_ITEM_BUFFER+DRV_FS_ROOT_LAST_ITEM+0x00,TEMP
_DRV_FS_OP_MD__REWRITEN_EL:
	LDI_T32 0x00000000
	MCALL _DRV_FS_BLOCK_WRITE

_DRV_FS_OP_MD__END:
	POP ACCUM
	POP LOOP_CNTR
	POP TEMP_EL
	POP TEMP_EH
	POP_Z
	POP_X
	RET
.endif
