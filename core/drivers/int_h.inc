;-----------------------------------------------------------------------------------------------------------------------
;Файл распространяется под лицензией GPL-3.0-or-later, https://www.gnu.org/licenses/gpl-3.0.txt
;-----------------------------------------------------------------------------------------------------------------------
;24.01.2021  w5277c@gmail.com			Начало
;-----------------------------------------------------------------------------------------------------------------------

.include	"./core/ram/ram_offset.inc"
.include	"./core/ram/ram_realloc.inc"
.include	"./mem/ram_fill8.inc"
.include	"./io/port_mode_in.inc"
.include	"./io/port_set_lo.inc"
.include	"./io/port_set_hi.inc"
.include	"./io/port_get.inc"
.include	"./io/port_get_byte.inc"
.include	"./conv/bitnum_to_num.inc"

;---CONSTANTS--------------------------------------------
	.EQU	_DRV_INT_H_ADDRS									= 0x00;1*8(PROC_ID)+2*8(адрес перехода) максимум 8 прерываний

	.EQU	_DRV_INT_H_RAM_SIZE								= 3*8
;--------------------------------------------------------
DRV_INT_H_INIT:
;--------------------------------------------------------
;Инициализация
;--------------------------------------------------------
	;Выделяем память
	LDI ACCUM,_DRV_INT_H_RAM_SIZE
	MCALL C5_RAM_REALLOC

	;Заполняем
	MOV XH,ZH
	MOV XL,ZL
	MOV LOOP_CNTR,ACCUM
	LDI TEMP,0xff
	MCALL RAM_FILL8

	;Завершаем инициализацию
	MCALL C5_READY
;--------------------------------------------------------
;Основной код, разрешаем прерывания и
;включаем необходимые флаги
;IN: TEMP_H-перывание (C5_IR_INT0...)
;TEMP_L-тип реакции(C5_ISC_...)
;Y - адрес обработчика
;FLAGS - PID(0xFF - отключить)
;--------------------------------------------------------
	PUSH_Z
	PUSH TEMP
	PUSH TEMP_H
	PUSH TEMP_L
	PUSH ACCUM

	CPI TEMP_H,0x04
	BRCC _DRV_INT_H__SECOND_PART
	LDS TEMP,MCUCR
;TODO

;--------------------------------------------------------
_DRV_INT_H_EVENT:
;--------------------------------------------------------
;Обработчик изменения состояния пина
;IN: ACCUM - номер строки в таблице прерываний
;При вызове ICALL первый бит FLAGS содержит состояние
;пина
;--------------------------------------------------------
;TODO
