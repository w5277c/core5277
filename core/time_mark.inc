;-----------------------------------------------------------------------------------------------------------------------
;Файл распространяется под лицензией GPL-3.0-or-later, https://www.gnu.org/licenses/gpl-3.0.txt
;-----------------------------------------------------------------------------------------------------------------------
;02.02.2021  w5277c@gmail.com			Начало
;-----------------------------------------------------------------------------------------------------------------------
.ifdef DEF_C5_TIME_MARK
.else
.set DEF_C5_TIME_MARK = 1

.include	"./core/uptime_copy.inc"

;--------------------------------------------------------
C5_TIME_MARK:
;--------------------------------------------------------
;Записываем в выделенную память временную метку (7 байт)
;IN: PID,TEMP-смещение на выделенные 7 байт, для хранения
;временной метки
;--------------------------------------------------------
	PUSH_Z
	PUSH_Y
	PUSH TEMP

	MCALL C5_RAM_OFFSET
	CLR YH
	MOV YL,TEMP
	ADD YL,ZL
	ADC YH,ZH

	LDS TEMP,SREG
	PUSH TEMP
	CLI

	MCALL C5_UPTIME_COPY
	LDS TEMP,_C5_MAIN_TIMER_CNTR
	ADIW YL,0x05
	ST Y+,TEMP
	_C5_TIMER_TCNT TEMP
	ST Y,TEMP

	POP TEMP
	STS SREG,TEMP

	POP TEMP
	POP_Y
	POP_Z
	RET
