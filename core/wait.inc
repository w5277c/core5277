;-----------------------------------------------------------------------------------------------------------------------
;Файл распространяется под лицензией GPL-3.0-or-later, https://www.gnu.org/licenses/gpl-3.0.txt
;-----------------------------------------------------------------------------------------------------------------------
;07.10.2019  w5277c@gmail.com			Начало
;09.08.2020  w5277c@gmail.com			Разбиение на файлы
;27.10.2020  w5277c@gmail.com			Обновлена информация об авторских правах
;-----------------------------------------------------------------------------------------------------------------------
.ifdef DEF_C5_WAIT
.else
.set DEF_C5_WAIT = 1

.include "./core/wait_2ms.inc"

;--------------------------------------------------------
C5_WAIT:
;--------------------------------------------------------
;Ждем 3 кванта времени
;--------------------------------------------------------
	PUSH TEMP_H
	;Не делаем WAIT если диспетчер заблокирован
	LDI TEMP_H,0x00
	CP _C5_DISPATCHER_LOCK_CNTR,TEMP_H
	BRNE _C5_WAIT__DISPATCHER_LOCKED
	PUSH TEMP_L
	PUSH TEMP
	LDI TEMP_H,0x00
	LDI TEMP_L,0x00
	LDI TEMP,0x03
	MCALL C5_WAIT_2MS
	POP TEMP
	POP TEMP_L
_C5_WAIT__DISPATCHER_LOCKED:
	POP TEMP_H
	RET
.endif
