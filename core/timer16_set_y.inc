;-----------------------------------------------------------------------------------------------------------------------
;Файл распространяется под лицензией GPL-3.0-or-later, https://www.gnu.org/licenses/gpl-3.0.txt
;-----------------------------------------------------------------------------------------------------------------------
;22.03.2022	konstantin@5277.ru			Начало
;-----------------------------------------------------------------------------------------------------------------------
.if TIMERS16>0x00
.ifdef DEF_C5_TIMER16_SET_Y
.else
.set DEF_C5_TIMER16_SET_Y = 1

.if REPORT_INCLUDES == 0x01
.message "included C5_TIMER16_SET_Y"
.endif

.include "./core/_timer16_offset.inc"

;--------------------------------------------------------
C5_TIMER16_SET_Y:
;--------------------------------------------------------
;Установка нового адреса выделенной памяти
;IN: TEMP-номер таймера(0-31),
;Y-адрес на выделенную память
;--------------------------------------------------------
	PUSH_Z
	MCALL _C5_TIMER16_OFFSET
	STD Z+_C5_TIMER16_RAM_ADDR+0x00,YH
	STD Z+_C5_TIMER16_RAM_ADDR+0x01,YL
	POP_Z
	RET
.endif
.endif