;-----------------------------------------------------------------------------------------------------------------------
;Файл распространяется под лицензией GPL-3.0-or-later, https://www.gnu.org/licenses/gpl-3.0.txt
;-----------------------------------------------------------------------------------------------------------------------
;28.05.2020	w5277c@gmail.com			Начало
;01.08.2020	w5277c@gmail.com			Разбиение на файлы
;27.10.2020	w5277c@gmail.com			Обновлена информация об авторских правах
;03.07.2021	w5277c@gmail.com			+Z,+Y
;-----------------------------------------------------------------------------------------------------------------------

.ifdef DEF_C5_RAM_OFFSET
.else
.set DEF_C5_RAM_OFFSET = 1

.if REPORT_INCLUDES == 0x01
.message "included C5_RAM_OFFSET"
.endif

;--------------------------------------------------------
C5_RAM_OFFSET:
;--------------------------------------------------------
;Получаем адрес выделенной памяти
;IN: PID-ид задачи или драйвера
;OUT: Y-смещение на начало выделенной памяти
;--------------------------------------------------------
	PUSH_Z
	MCALL _C5_PROC_HEADER_GET
	LDD YH,Z+_C5_PROC_RAM_OFFSET+0x00
	LDD YL,Z+_C5_PROC_RAM_OFFSET+0x01
	POP_Z
	RET
.endif
