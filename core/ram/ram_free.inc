;-----------------------------------------------------------------------------------------------------------------------
;Файл распространяется под лицензией GPL-3.0-or-later, https://www.gnu.org/licenses/gpl-3.0.txt
;-----------------------------------------------------------------------------------------------------------------------
;28.05.2020	w5277c@gmail.com			Начало
;01.08.2020	w5277c@gmail.com			Разбиение на файлы
;27.10.2020	w5277c@gmail.com			Обновлена информация об авторских правах
;03.07.2021	w5277c@gmail.com			Z->Y
;-----------------------------------------------------------------------------------------------------------------------
.ifdef DEF_C5_RAM_FREE
.else
.set DEF_C5_RAM_FREE = 1

.if REPORT_INCLUDES == 0x01
.message "included C5_RAM_FREE"
.endif

.include	"./core/ram/ram_realloc.inc"

;--------------------------------------------------------
C5_RAM_FREE:
;--------------------------------------------------------
;Освобождаем выделенную память
;IN: PID
;--------------------------------------------------------
	PUSH ACCUM
	PUSH_Y

	MOV ACCUM,C0x00
	MCALL C5_RAM_REALLOC

	POP_Y
	POP ACCUM
	RET
.endif
