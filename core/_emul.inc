
NOP		0000 0000 0000 0000
MOVW		0000 0001
-MULS		0000 0010
-MULSU		0000 0011 0ddd 0rrr
-FMULL 	0000 0011 0ddd 1rrr
-FMULLS	0000 0011 1ddd 0rrr
-FMULLSU	0000 0011 1ddd 1rrr

CPC	0000 01
SBC	0000 10
ADD	0000 11
CPSE	0001 00
CP		0001 01
SUB	0001 10
ADC	0001 11
AND	0010 00
EOR	0010 01
OR		0010 10
MOV	0010 11
CPI	0011
SBCI	0100
SUBI	0101
ORI	0110
ANDI	0111

LD4	1000 000d dddd 1000
LD8	1000 000d dddd 0000
ST8	1000 001r rrrr 0000
ST4	1000 001r rrrr 1000

LDS	1001 000d dddd 0000
LD9	1001 000d dddd 0001
LD10	1001 000d dddd 0010
LPM1	1001 000d dddd 0100
LPM2	1001 000d dddd 0101
ELPM2	1001 000d dddd 0110
ELPM3 1001 000d dddd 0111
LD5	1001 000d dddd 1001
LD6	1001 000d dddd 1010
LD1	1001 000d dddd 1100
LD2	1001 000d dddd 1101
LD3	1001 000d dddd 1110
POP	1001 000d dddd 1111

STS	1001 001d dddd 0000
ST9	1001 001r rrrr 0001
ST10	1001 001r rrrr 0010
ST5	1001 001r rrrr 1001
ST6	1001 001r rrrr 1010
ST1	1001 001r rrrr 1100
ST2	1001 001r rrrr 1101
ST3	1001 001r rrrr 1110
PUSH	1001 001d dddd 1111



ASR	1001 010
BCLR	1001 0100 1sss 1000
BSET	1001 0100 0sss 1000
-JMP	1001 010k kkkk 110k...
-IJMP	1001 0100 0000 1001
-EIJMP	1001 0100 0001 1001
COM	1001 010d dddd 0000
NEG	1001 010d dddd 0001
SWAP	1001 010d dddd 0010
INC	1001 010d dddd 0011
LSR	1001 010d dddd 0110
ROR	1001 010d dddd 0111
DEC	1001 010d dddd 1010
LPM3	1001 0101 1100 1000
RET	1001 0101 0000 1000
-ICALL 1001 0101 0000 1001
-RETI	1001 0101 0001 1000
-EICALL1001 0101 0001 1001
-SLEEP	1001 0101 1000 1000
BREAK	1001 0101 1001 1000
-WDR	1001 0101 1010 1000
ELPM1 1001 0101 1101 1000
SPM	1001 0101 1110 1000
-CALL	1001 010k kkkk 111k

ADIW	1001 0110
SBIW	1001 0111

-CBI	1001 1000
-SBIC	1001 1001
-SBI	1001 1010
-SBIS	1001 1011

-MUL	1001 11




LD11	10q0 qq0d dddd 0qqq
LD7	10q0 qq0d dddd 1qqq
ST11	10q0 qq1r rrrr 0qqq
ST7	10q0 qq1r rrrr 1qqq

-IN		1011 0
-OUT	1011 1
RJMP	1100
LD12	1110
SER	1110 1111 dddd 1111
RCALL	1101
BLD	1111 100
SBRC	1111 110
SBRS	1111 111

BRBC	1111 01
BRBS	1111 00

BST	1111 101d dddd 0bbb



LSL	= ADD Rd,Rd
ROL	= ADC Rd,Rd
TST	= AND Rd,Rd
CLR	= EOR Rd,Rd
CBR 	= ANDI
SBR	= ORI
CLC	=BCLR 000
SEC	=BSET 000
CLZ	=BCLR 001
SEZ	=BSET 001
CLN	=BCLR 010
SEN	=BSET 010
CLV	=BCLR 011
SEV	=BSET 011
CLS	=BCLR 100
SES	=BSET 100
CLH	=BCLR 101
SEH	=BSET 101
CLT	=BCLR 110
SET	=BSET 110
CLI	=BCLR 111
SEI	=BSET 111

BRCC	= BRBC (s=000)	?
BRSH	= BRBC (s=000)	?
BRCS	= BRBS (s=000)	?
BRLO	= BRBS (s=000)	?
BRNE	= BRBC (s=001)
BREQ	= BRBS (s=001)
BRPL	= BRBC (s=010)
BRMI	= BRBS (s=010)
BRVC	= BRBC (s=011)
BRVS	= BRBS (s=011)
BRGE	= BRBC (s=100)
BRLT	= BRBS (s=100)
BRHC	= BRBC (s=101)
BRHS	= BRBS (s=101)
BRTC	= BRBC (s=110)
BRTS	= BRBS (s=110)
BRID	= BRBC (s=111)
BRIE	= BRBS (s=111)
