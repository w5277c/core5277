;-----------------------------------------------------------------------------------------------------------------------
;Файл распространяется под лицензией GPL-3.0-or-later, https://www.gnu.org/licenses/gpl-3.0.txt
;-----------------------------------------------------------------------------------------------------------------------
;26.12.2020	w5277c@gmail.com			Начало
;-----------------------------------------------------------------------------------------------------------------------
.ifdef DEF_C5_FS
.else
.set DEF_C5_FS = 1

;---FS-COMMANDS------------------------------------------;Кманды поддерживаемые FS
	.EQU	C5_FS_CMD_PGET							= 0x01			;Считать параметр
	.EQU	C5_FS_CMD_PSET							= 0x02			;Записать параметр
	;---
	.EQU	C5_FS_CMD_FORMAT						= 0x10			;Создать новую FS на устройстве
	.EQU	C5_FS_CMD_DEFRAG						= 0x11			;Дефрагментировать FS
	.EQU	C5_FS_CMD_HEAD							= 0x12			;Получить заголовок элемента каталога
	.EQU	C5_FS_CMD_CD							= 0x13			;Перейти в каталог
	.EQU	C5_FS_CMD_MD							= 0x14			;Создать каталог
	.EQU	C5_FS_CMD_CREATE						= 0x15			;Создать файл
	.EQU	C5_FS_CMD_RM							= 0x16			;Удалить каталог или файл
	.EQU	C5_FS_CMD_COPY							= 0x1b			;Скопировать данные файла в новый файл
	.EQU	C5_FS_CMD_MOVE							= 0x1c			;Переименовать/переместить файл
	;---
	.EQU	C5_FS_CMD_OPEN							= 0x20			;Открыть файл
	.EQU	C5_FS_CMD_READ							= 0x21			;Считать данные с файла
	.EQU	C5_FS_CMD_WRITE						= 0x22			;Записать данные в файл
	.EQU	C5_FS_CMD_VERIFY						= 0x23			;Проверить записанные данные
	.EQU	C5_FS_CMD_CLOSE						= 0x2f			;Закрыть файл

;---FS-RESULT-CODE---------------------------------------;Код результата
	.EQU	C5_FS_RESULT_OK						= 0x00			;
	.EQU	C5_FS_RESULT_WRONG_BLOCK			= 0x81			;


	.EQU	_C5_FS_BLOC
