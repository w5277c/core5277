;-----------------------------------------------------------------------------------------------------------------------
;Файл распространяется под лицензией GPL-3.0-or-later, https://www.gnu.org/licenses/gpl-3.0.txt
;-----------------------------------------------------------------------------------------------------------------------
;26.12.2020	w5277c@gmail.com			Начало
;-----------------------------------------------------------------------------------------------------------------------
.ifdef DEF_C5_DISK
.else
.set DEF_C5_DISK = 1


;---DISK-COMMANDS----------------------------------------;Кманды поддерживаемые FS
	.EQU	C5_DISK_CMD_PGET							= 0x01		;Считать параметр
	.EQU	C5_DISK_CMD_PSET							= 0x02		;Записать параметр
	.EQU	C5_DISK_CMD_BREAD							= 0x03		;Считать данные с блока
	.EQU	C5_DISK_CMD_BWRITE						= 0x04		;Записать данные в блок
	.EQU	C5_DISK_CMD_BVERIFY						= 0x05		;Проверить данные в блоке
