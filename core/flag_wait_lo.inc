;-----------------------------------------------------------------------------------------------------------------------
;Файл распространяется под лицензией GPL-3.0-or-later, https://www.gnu.org/licenses/gpl-3.0.txt
;-----------------------------------------------------------------------------------------------------------------------
;07.10.2019	w5277c@gmail.com			Начало
;04.08.2020	w5277c@gmail.com			Разбиение на файлы
;27.10.2020	w5277c@gmail.com			Обновлена информация об авторских правах
;07.08.2023	konstantin@5277.ru		Замена флага Z на C
;-----------------------------------------------------------------------------------------------------------------------
.ifdef DEF_C5_FLAG_WAIT_LO
.else
.set DEF_C5_FLAG_WAIT_LO = 1

.if REPORT_INCLUDES == 0x01
.message "included C5_FLAG_WAIT_LO"
.endif

.include	"./inc/core/flag_get.inc"
.include	"./inc/core/wait.inc"

;--------------------------------------------------------
C5_FLAG_WAIT_LO:
;--------------------------------------------------------
;Ожидание состояния флага в состоянии LO
;IN:TEMP - номер флага(0-63)
;--------------------------------------------------------
	MCALL C5_FLAG_GET
	BRCS PC+0x02
	RET

	;Проверка на вызванную процедуру из прерывания
	CPI _PID,0xff
	BREQ C5_FLAG_WAIT_LO
	;Спим некоторое время
	MCALL C5_WAIT
	RJMP C5_FLAG_WAIT_LO
.endif
