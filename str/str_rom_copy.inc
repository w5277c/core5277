;-----------------------------------------------------------------------------------------------------------------------
;Файл распространяется под лицензией GPL-3.0-or-later, https://www.gnu.org/licenses/gpl-3.0.txt
;-----------------------------------------------------------------------------------------------------------------------
;12.01.2023	konstantin@5277.ru		Начало
;-----------------------------------------------------------------------------------------------------------------------
.ifdef DEF_STR_ROM_COPY
.else
.set DEF_STR_ROM_COPY = 1

.if REPORT_INCLUDES == 0x01
.message "included STR_ROM_COPY"
.endif

;--------------------------------------------------------
STR_ROM_COPY:
;--------------------------------------------------------
;Копирование строки из ROM
;IN: Z-SRC адрес, X-DST адрес
;--------------------------------------------------------
	PUSH_Z
	PUSH_X
	PUSH TEMP

STR_ROM_COPY__LOOP:
	LPM TEMP,Z+
	ST X+,TEMP
	CPI TEMP,0x00
	BRNE STR_ROM_COPY__LOOP

	POP TEMP
	POP_X
	POP_Z
	RET
.endif
