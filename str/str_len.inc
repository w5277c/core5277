;-----------------------------------------------------------------------------------------------------------------------
;Файл распространяется под лицензией GPL-3.0-or-later, https://www.gnu.org/licenses/gpl-3.0.txt
;-----------------------------------------------------------------------------------------------------------------------
;29.04.2021	w5277c@gmail.com			Начало
;01.10.2021	w5277c@gmail.com			Y->X
;-----------------------------------------------------------------------------------------------------------------------
.ifdef DEF_STR_LEN
.else
.set DEF_STR_LEN = 1

.if REPORT_INCLUDES == 0x01
.message "included STR_LEN"
.endif

;--------------------------------------------------------
STR_LEN:
;--------------------------------------------------------
;Вычисление размера строки
;IN: X-SRC адрес
;OUT: TEMP-размер без учета 0x00 (0xff-переполнение)
;--------------------------------------------------------
	PUSH_X
	PUSH ACCUM

	CLR TEMP
STR_LEN__LOOP:
	LD ACCUM,X+
	CPI ACCUM,0x00
	BREQ STR_LEN__END
	INC TEMP
	CPI TEMP,0xff
	BRNE STR_LEN__LOOP

STR_LEN__END:
	POP ACCUM
	POP_X
	RET
.endif
