;-----------------------------------------------------------------------------------------------------------------------
;Файл распространяется под лицензией GPL-3.0-or-later, https://www.gnu.org/licenses/gpl-3.0.txt
;-----------------------------------------------------------------------------------------------------------------------
;29.04.2021	w5277c@gmail.com			Начало
;01.10.2021	w5277c@gmail.com			Y->Z
;-----------------------------------------------------------------------------------------------------------------------
.ifdef DEF_STR_COPY
.else
.set DEF_STR_COPY = 1

.if REPORT_INCLUDES == 0x01
.message "included STR_COPY"
.endif

;--------------------------------------------------------
STR_COPY:
;--------------------------------------------------------
;Копирование строки
;IN: Z-SRC адрес, X-DST адрес
;--------------------------------------------------------
	PUSH_Z
	PUSH_X
	PUSH TEMP

STR_COPY__LOOP:
	LD TEMP,Z+
	ST X+,TEMP
	CPI TEMP,0x00
	BRNE STR_COPY__LOOP

	POP TEMP
	POP_X
	POP_Z
	RET
.endif
