;-----------------------------------------------------------------------------------------------------------------------
;Файл распространяется под лицензией GPL-3.0-or-later, https://www.gnu.org/licenses/gpl-3.0.txt
;-----------------------------------------------------------------------------------------------------------------------
;01.10.2021	w5277c@gmail.com			Начало
;-----------------------------------------------------------------------------------------------------------------------
.ifdef DEF_STR_REPLACE
.else
.set DEF_STR_REPLACE = 1

.if REPORT_INCLUDES == 0x01
.message "included STR_REPLACE"
.endif

;--------------------------------------------------------
STR_REPLACE:
;--------------------------------------------------------
;Поиск подстроки в строке и замена найденного блока на
;новую строку
;IN: X-адрес на основной блок, Z-адрес на искомый блок,
;Y-адрес на новую строку, TEMP_H-максимальный размер
;доступной памяти
;OUT: TEMP_H-результат(0xff-не найдено,0xfe-переполнение)
;--------------------------------------------------------
	;TODO
	RET
.endif
