;-----------------------------------------------------------------------------------------------------------------------
;Файл распространяется под лицензией GPL-3.0-or-later, https://www.gnu.org/licenses/gpl-3.0.txt
;-----------------------------------------------------------------------------------------------------------------------
;07.10.2019  w5277c@gmail.com        Начало
;01.08.2020  w5277c@gmail.com        Разбиение на файлы
;27.10.2020  w5277c@gmail.com        Обновлена информация об авторских правах
;-----------------------------------------------------------------------------------------------------------------------
.ifdef DEF_C5_BITNUM_TO_NUM
.else
.set DEF_C5_BITNUM_TO_NUM = 1

;--------------------------------------------------------
C5_BITNUM_TO_NUM:
;--------------------------------------------------------
;Конвертирование байта в HEX(два ASCII символа)
;IN: TEMP - номер бита(0-7)
;OUT: TEMP - число(1,2,4,8,16,32,64,128)
;-START--------------------------------------------------
	PUSH TEMP_L
	LDI TEMP_L,0x01
	TST TEMP
	BREQ _C5_BITNUM_TO_NUM__END
_C5_BITNUM_TO_NUM__LOOP:
	LSL TEMP_L
	DEC TEMP
	BRNE _C5_BITNUM_TO_NUM__LOOP
_C5_BITNUM_TO_NUM__END:
	MOV TEMP,TEMP_L
	POP TEMP_L
	RET
.endif
