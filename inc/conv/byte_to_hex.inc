;-----------------------------------------------------------------------------------------------------------------------
;Файл распространяется под лицензией GPL-3.0-or-later, https://www.gnu.org/licenses/gpl-3.0.txt
;-----------------------------------------------------------------------------------------------------------------------
;07.10.2019  w5277c@gmail.com        Начало
;01.08.2020  w5277c@gmail.com        Разбиение на файлы
;27.10.2020  w5277c@gmail.com        Обновлена информация об авторских правах
;-----------------------------------------------------------------------------------------------------------------------
.ifndef DEF_C5_BYTE_TO_HEX
.set DEF_C5_BYTE_TO_HEX = 1

;--------------------------------------------------------
C5_BYTE_TO_HEX:
;--------------------------------------------------------
;Конвертирование байта в HEX(два ASCII символа)
;IN: TEMP - байт
;OUT: TEMP_H,TEMP_L - ASCII
;--------------------------------------------------------
	MOV TEMP_L,TEMP
	ANDI TEMP_L,0x0f
	CPI TEMP_L,0x0a
	BRCS PC+0x02
	SUBI TEMP_L,(0x100-0x07)											;+0x07
	SUBI TEMP_L,(0x100-0x30)											;+0x30
	MOV TEMP_H,TEMP
	SWAP TEMP_H
	ANDI TEMP_H,0x0f
	CPI TEMP_H,0x0a
	BRCS PC+0x02
	SUBI TEMP_H,(0x100-0x07)											;+0x07
	SUBI TEMP_H,(0x100-0x30)											;+0x30
	RET
.endif
