;-----------------------------------------------------------------------------------------------------------------------
;Владельцем данного исходного кода является Удовиченко Константин Александрович, емайл:w5277c@gmail.com, по всем
;правовым вопросам обращайтесь на email.
;-----------------------------------------------------------------------------------------------------------------------
;07.10.2019  w5277c@gmail.com        Начало
;01.08.2020  w5277c@gmail.com        Разбиение на файлы
;-----------------------------------------------------------------------------------------------------------------------
.ifdef DEF_CORE5277_CRC8_MAXIM
.else
.set DEF_CORE5277_CRC8_MAXIM = 1

;--------------------------------------------------------
CORE5277_CRC8_MAXIM:
;--------------------------------------------------------
;Подсчет CRC
;IN: TEMP - байт, ACCUM - сумма
;OUT: ACCUM - сумма
;-START--------------------------------------------------
	PUSH TEMP_L
	PUSH LOOP_CNTR
	LDI TEMP_L,0x8C
	EOR ACCUM,TEMP
	LDI LOOP_CNTR,0x08
_CORE5277_CRC8_MAXIM__LOOP:
	LSR ACCUM
	BRCC PC+0x02
	EOR ACCUM,TEMP_L
	DEC LOOP_CNTR
	BRNE _CORE5277_CRC8_MAXIM__LOOP
	POP LOOP_CNTR
	POP TEMP_L
	RET
.endif
