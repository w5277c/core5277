;-----------------------------------------------------------------------------------------------------------------------
;Владельцем данного исходного кода является Удовиченко Константин Александрович, емайл:w5277c@gmail.com, по всем
;правовым вопросам обращайтесь на email.
;-----------------------------------------------------------------------------------------------------------------------
;07.10.2019  w5277c@gmail.com        Начало
;01.08.2020  w5277c@gmail.com        Разбиение на файлы
;-----------------------------------------------------------------------------------------------------------------------
.ifdef DEF_CORE5277_BIT_FROM_WORD
.else
.set DEF_CORE5277_BIT_FROM_WORD = 1

;--------------------------------------------------------
CORE5277_BIT_FROM_WORD:
;--------------------------------------------------------
;Возвращает значение бита в флаге C
;IN:Y - 16бит значение, TEMP - номер бита(0-15)
;OUT: флаг C
;-START--------------------------------------------------
	SBRC TEMP,0x03
	MOV YL,YH
	SBRC TEMP,0x02
	SWAP YL
	ANDI TEMP,0x03
	INC TEMP
CORE5277_BIT_FROM_WORD__LOOP:
	LSR YL
	DEC TEMP
	BRNE CORE5277_BIT_FROM_WORD__LOOP
	RET
.endif
