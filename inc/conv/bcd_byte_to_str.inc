;-----------------------------------------------------------------------------------------------------------------------
;Владельцем данного исходного кода является Удовиченко Константин Александрович, емайл:w5277c@gmail.com, по всем
;правовым вопросам обращайтесь на email.
;-----------------------------------------------------------------------------------------------------------------------
;07.10.2019  w5277c@gmail.com        Начало
;01.08.2020  w5277c@gmail.com        Разбиение на файлы
;-----------------------------------------------------------------------------------------------------------------------
.ifdef DEF_CORE5277_BCD_BYTE_TO_STR
.else
.set DEF_CORE5277_BCD_BYTE_TO_STR = 1

;--------------------------------------------------------
CORE5277_BCD_BYTE_TO_STR:
;--------------------------------------------------------
;Конвертирование байта в формате BCD в STR(два ASCII символа)
;IN: TEMP - байт
;OUT: TEMP_H,TEMP_L - ASCII
;-START--------------------------------------------------
	MOV TEMP_H,TEMP
	SWAP TEMP_H
	ANDI TEMP_H,0x0f
	SUBI TEMP_H,(0x100-0x30)
	MOV TEMP_L,TEMP
	ANDI TEMP_L,0x0f
	SUBI TEMP_L,(0x100-0x30)
	RET
.endif
