;-----------------------------------------------------------------------------------------------------------------------
;Файл распространяется под лицензией GPL-3.0-or-later, https://www.gnu.org/licenses/gpl-3.0.txt
;-----------------------------------------------------------------------------------------------------------------------
;07.10.2019  w5277c@gmail.com        Начало
;01.08.2020  w5277c@gmail.com        Разбиение на файлы
;27.10.2020  w5277c@gmail.com        Обновлена информация об авторских правах
;-----------------------------------------------------------------------------------------------------------------------
.ifdef DEF_C5_RAM_COPY8
.else
.set DEF_C5_RAM_COPY8 = 1

;--------------------------------------------------------
C5_RAM_COPY8:
;--------------------------------------------------------
;Копирование блока памяти
;IN: X-SRC адрес, Z-DST адрес, LOOP_CNTR-длина
;-START--------------------------------------------------
	PUSH XH
	PUSH XL
	PUSH ZH
	PUSH ZL
	PUSH LOOP_CNTR
	PUSH TEMP
_C5_RAM_COPY8__LOOP:
	LD TEMP,X+
	ST Z+,TEMP
	DEC LOOP_CNTR
	BRNE _C5_RAM_COPY8__LOOP
	POP TEMP
	POP LOOP_CNTR
	POP ZL
	POP ZH
	POP XL
	POP XH
	RET
.endif
