;-----------------------------------------------------------------------------------------------------------------------
;Файл распространяется под лицензией GPL-3.0-or-later, https://www.gnu.org/licenses/gpl-3.0.txt
;-----------------------------------------------------------------------------------------------------------------------
;07.10.2019  w5277c@gmail.com        Начало
;01.08.2020  w5277c@gmail.com        Разбиение на файлы
;27.10.2020  w5277c@gmail.com        Обновлена информация об авторских правах
;-----------------------------------------------------------------------------------------------------------------------
.ifndef DEF_C5_RAM_COPY8_DESC
.set DEF_C5_RAM_COPY8_DESC = 1

;--------------------------------------------------------
C5_RAM_COPY8_DESC:
;--------------------------------------------------------
;Копирование блока памяти(с декрементом смещений)
;IN: X-SRC адрес, Z-DST адрес, LOOP_CNTR-длина
;-START--------------------------------------------------
	PUSH XH
	PUSH XL
	PUSH ZH
	PUSH ZL
	PUSH LOOP_CNTR
	PUSH TEMP
_C5_RAM_COPY8_DESC__LOOP:
	LD TEMP,X
	ST Z,TEMP
	SUBI XL,0x01
	SBCI XH,0x00
	SUBI ZL,0x01
	SBCI ZH,0x00
	DEC LOOP_CNTR
	BRNE _C5_RAM_COPY8_DESC__LOOP
	POP TEMP
	POP LOOP_CNTR
	POP ZL
	POP ZH
	POP XL
	POP XH
	RET
.endif
