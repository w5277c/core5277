;-----------------------------------------------------------------------------------------------------------------------
;Владельцем данного исходного кода является Удовиченко Константин Александрович, емайл:w5277c@gmail.com, по всем
;правовым вопросам обращайтесь на email.
;-----------------------------------------------------------------------------------------------------------------------
;28.05.2020  w5277c@gmail.com        Начало
;01.08.2020  w5277c@gmail.com        Разбиение на файлы
;-----------------------------------------------------------------------------------------------------------------------
.ifdef DEF_CORE5277_RAM_OFFSET
.else
.set DEF_CORE5277_RAM_OFFSET = 1

;--------------------------------------------------------
CORE5277_RAM_OFFSET:
;--------------------------------------------------------
;Получаем адрес выделенной памяти
;IN: PID - ид задачи или драйвера
;OUT: Z - смещение на начало выделенной памяти
;--------------------------------------------------------
	PUSH TEMP
	MCALL _CORE5277_PROC_HEADER_GET
	LDD TEMP,Z+_CORE5277_PROC_RAM_OFFSET+0x00
	LDD ZL,Z+_CORE5277_PROC_RAM_OFFSET+0x01
	MOV ZH,TEMP
	POP TEMP
	RET
.endif
