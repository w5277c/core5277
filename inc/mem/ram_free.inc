;-----------------------------------------------------------------------------------------------------------------------
;Владельцем данного исходного кода является Удовиченко Константин Александрович, емайл:w5277c@gmail.com, по всем
;правовым вопросам обращайтесь на email.
;-----------------------------------------------------------------------------------------------------------------------
;28.05.2020  w5277c@gmail.com        Начало
;01.08.2020  w5277c@gmail.com        Разбиение на файлы
;-----------------------------------------------------------------------------------------------------------------------
.ifdef DEF_CORE5277_RAM_FREE
.else
.set DEF_CORE5277_RAM_FREE = 1

.include	"./inc/mem/ram_realloc.inc"

;--------------------------------------------------------
CORE5277_RAM_FREE:
;--------------------------------------------------------
;Освобождаем выделенную память
;IN: PID
;--------------------------------------------------------
	PUSH ACCUM
	PUSH TEMP
	PUSH_Z

	LDI ACCUM,0x00
	MCALL CORE5277_RAM_REALLOC

	POP_Z
	POP TEMP
	POP ACCUM
	RET
.endif
