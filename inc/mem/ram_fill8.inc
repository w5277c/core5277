;-----------------------------------------------------------------------------------------------------------------------
;Файл распространяется под лицензией GPL-3.0-or-later, https://www.gnu.org/licenses/gpl-3.0.txt
;-----------------------------------------------------------------------------------------------------------------------
;07.10.2019  w5277c@gmail.com        Начало
;01.08.2020  w5277c@gmail.com        Разбиение на файлы
;27.10.2020  w5277c@gmail.com        Обновлена информация об авторских правах
;-----------------------------------------------------------------------------------------------------------------------
.ifndef DEF_C5_RAM_FILL8
.set DEF_C5_RAM_FILL8 = 1

;--------------------------------------------------------
C5_RAM_FILL8:
;--------------------------------------------------------
;Заполнение блока памяти значением
;IN: X-адрес, TEMP-значение, LOOP_CNTR-длина
;-START--------------------------------------------------
	PUSH XH
	PUSH XL
	PUSH LOOP_CNTR
_C5_RAM_FILL8__LOOP:
	ST X+,TEMP
	DEC LOOP_CNTR
	BRNE _C5_RAM_FILL8__LOOP
	POP LOOP_CNTR
	POP XL
	POP XH
	RET
.endif
