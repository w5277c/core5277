;-----------------------------------------------------------------------------------------------------------------------
;Файл распространяется под лицензией GPL-3.0-or-later, https://www.gnu.org/licenses/gpl-3.0.txt
;-----------------------------------------------------------------------------------------------------------------------
;28.05.2020  w5277c@gmail.com        Начало
;01.08.2020  w5277c@gmail.com        Разбиение на файлы
;27.10.2020  w5277c@gmail.com        Обновлена информация об авторских правах
;-----------------------------------------------------------------------------------------------------------------------
.ifndef DEF_C5_RAM_CHECK_STACK
.set DEF_C5_RAM_CHECK_STACK = 1

;--------------------------------------------------------
_C5_RAM_CHECK_STACK:
;--------------------------------------------------------
;Проверяем на влияние на стек
;IN: Y - адрес блока, ACCUM - длина
;OUT: flag Z(true - влияния нет)
;--------------------------------------------------------
	PUSH_X
	PUSH_Y
	PUSH ACCUM

	;Считаем конец блока
	ADD YL,ACCUM
	CLR ACCUM
	ADC YH,ACCUM
	;Получаем адрес вершины стека
	LDS XH,_C5_TOP_OF_STACK+0x00
	LDS XL,_C5_TOP_OF_STACK+0x01
	;Находим разницу
	SUB XL,YL
	SBC XH,YH
	BRCS _C5_RAM_CHECK_STACK__FAIL
	;Учитываем минимально допустимый размер
	SUBI XL,_C5_RAM_BORDER_SIZE
	SBCI XH,0x00
	BRCS _C5_RAM_CHECK_STACK__FAIL
	SEZ
	RJMP _C5_RAM_CHECK_STACK__END
_C5_RAM_CHECK_STACK__FAIL:
	CLZ
_C5_RAM_CHECK_STACK__END:
	POP ACCUM
	POP_Y
	POP_X
	RET
.endif
