;-----------------------------------------------------------------------------------------------------------------------
;Владельцем данного исходного кода является Удовиченко Константин Александрович, емайл:w5277c@gmail.com, по всем
;правовым вопросам обращайтесь на email.
;-----------------------------------------------------------------------------------------------------------------------
;07.10.2019  w5277c@gmail.com        Начало
;01.08.2020  w5277c@gmail.com        Разбиение на файлы
;-----------------------------------------------------------------------------------------------------------------------
.ifdef DEF_CORE5277_RAM_FILL16
.else
.set DEF_CORE5277_RAM_FILL16 = 1

;--------------------------------------------------------
CORE5277_RAM_FILL16:
;--------------------------------------------------------
;Заполнение блока памяти значением
;IN: X-адрес, TEMP-значение, TEMP_H/TEMP_L-длина
;-START--------------------------------------------------
	PUSH XH
	PUSH ZL
	PUSH TEMP_H
	PUSH TEMP_L
_CORE5277_RAM_FILL16__LOOP:
	ST X+,TEMP
	SUBI TEMP_L,0x01
	SBCI TEMP_H,0x00
	CPI TEMP_H,0x00
	BRNE _CORE5277_RAM_FILL16__LOOP
	CPI TEMP_L,0x00
	BRNE _CORE5277_RAM_FILL16__LOOP
	POP TEMP_H
	POP TEMP_L
	POP XL
	POP XH
	RET
.endif
