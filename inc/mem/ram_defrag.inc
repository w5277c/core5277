;-----------------------------------------------------------------------------------------------------------------------
;Владельцем данного исходного кода является Удовиченко Константин Александрович, емайл:w5277c@gmail.com, по всем
;правовым вопросам обращайтесь на email.
;-----------------------------------------------------------------------------------------------------------------------
;28.05.2020  w5277c@gmail.com        Начало
;01.08.2020  w5277c@gmail.com        Разбиение на файлы
;-----------------------------------------------------------------------------------------------------------------------
.ifdef DEF_CORE5277_RAM_DEFRAG
.else
.set DEF_CORE5277_RAM_DEFRAG = 1

;--------------------------------------------------------
CORE5277_RAM_DEFRAG:
;--------------------------------------------------------
;Дефрагментация памяти, т.е. по сути, сдвигает выделенный
;блок в начало памяти, если перед задачей есть свободное
;пространство.
;Задача может вызывать этот метод для общей экономии
;памяти. При этом адресация меняется, т.е. задача не
;должна иметь смещений на что-либо внутри старого блока
;памяти.
;IN: PID
;--------------------------------------------------------
	MCALL CORE5277_DISPATCHER_LOCK
	;TODO
	MCALL CORE5277_DISPATCHER_UNLOCK
	RET
.endif
