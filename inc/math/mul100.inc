;-----------------------------------------------------------------------------------------------------------------------
;Владельцем данного исходного кода является Удовиченко Константин Александрович, емайл:w5277c@gmail.com, по всем
;правовым вопросам обращайтесь на email.
;-----------------------------------------------------------------------------------------------------------------------
;08.10.2020  w5277c@gmail.com        Начало
;-----------------------------------------------------------------------------------------------------------------------
.ifdef DEF_CORE5277_MUL100
.else
.set DEF_CORE5277_MUL100 = 1

;--------------------------------------------------------
CORE5277_MUL100:
;--------------------------------------------------------
;Умножение 8b числа на 100
;IN: TEMP - 8b число
;OUT: TEMP_H,TEMP_L результат
;--------------------------------------------------------
	PUSH _RESULT_H
	PUSH _RESULT_L
	PUSH ACCUM

	LDI ACCUM,100
	MUL TEMP,ACCUM
	MOV TEMP_H,_RESULT_H
	MOV TEMP_L,_RESULT_L

	POP ACCUM
	POP _RESULT_L
	POP _RESULT_H
	RET
.endif
