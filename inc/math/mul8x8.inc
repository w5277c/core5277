;-----------------------------------------------------------------------------------------------------------------------
;Владельцем данного исходного кода является Удовиченко Константин Александрович, емайл:w5277c@gmail.com, по всем
;правовым вопросам обращайтесь на email.
;-----------------------------------------------------------------------------------------------------------------------
;07.10.2019  w5277c@gmail.com        Начало
;01.08.2020  w5277c@gmail.com        Разбиение на файлы
;-----------------------------------------------------------------------------------------------------------------------
.ifdef DEF_CORE5277_MUL8X8
.else
.set DEF_CORE5277_MUL8X8 = 1

;--------------------------------------------------------
CORE5277_MUL8X8:
;--------------------------------------------------------
;Умножение 8b числа на 8б число
;IN: TEMP_L - 8b число, TEMP - 8b число
;OUT: TEMP_H, TEMP_L - 16b результат
;--------------------------------------------------------
	PUSH _RESULT_H
	PUSH _RESULT_L

	MUL TEMP_L,TEMP
	MOV TEMP_L,_RESULT_L
	MOV TEMP_H,_RESULT_H

	POP _RESULT_L
	POP _RESULT_H
	RET
.endif
