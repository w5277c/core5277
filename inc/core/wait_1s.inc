;-----------------------------------------------------------------------------------------------------------------------
;Владельцем данного исходного кода является Удовиченко Константин Александрович, емайл:w5277c@gmail.com, по всем
;правовым вопросам обращайтесь на email.
;-----------------------------------------------------------------------------------------------------------------------
;07.10.2019  w5277c@gmail.com        Начало
;09.08.2020  w5277c@gmail.com        Разбиение на файлы
;-----------------------------------------------------------------------------------------------------------------------
.ifdef DEF_CORE5277_WAIT_1S
.else
.set DEF_CORE5277_WAIT_1S = 1

.include "./inc/core/wait_2ms.inc"

;--------------------------------------------------------
CORE5277_WAIT_1S:
;--------------------------------------------------------
;Ждем
;IN TEMP - время в 1s
;--------------------------------------------------------
	PUSH TEMP_H
	PUSH TEMP_L
	PUSH TEMP
	PUSH LOOP_CNTR

	MOV LOOP_CNTR,TEMP
_CORE5277_WAIT_SEC__LOOP:
	CLR TEMP_H
	LDI TEMP_L,0x01
	LDI TEMP,0xf4
	MCALL CORE5277_WAIT_2MS
	DEC LOOP_CNTR
	BRNE _CORE5277_WAIT_SEC__LOOP

_CORE5277_WAIT_SEC__END:
	POP LOOP_CNTR
	POP TEMP
	POP TEMP_L
	POP TEMP_H
	RET
.endif
