;-----------------------------------------------------------------------------------------------------------------------
;Владельцем данного исходного кода является Удовиченко Константин Александрович, емайл:w5277c@gmail.com, по всем
;правовым вопросам обращайтесь на email.
;-----------------------------------------------------------------------------------------------------------------------
;07.10.2019  w5277c@gmail.com        Начало
;04.08.2020  w5277c@gmail.com        Разбиение на файлы
;-----------------------------------------------------------------------------------------------------------------------
.ifdef DEF_CORE5277_FLAG_WAIT_CHANGE
.else
.set DEF_CORE5277_FLAG_WAIT_CHANGE = 1

.include	"./inc/core/flag_get.inc"
.include	"./inc/core/flag_wait_lo.inc"
.include	"./inc/core/flag_wait_hi.inc"

;--------------------------------------------------------
CORE5277_FLAG_WAIT_CHANGE:
;--------------------------------------------------------
;Ожидание изменения состояния флага
;IN:TEMP - номер флага(0-63)
;--------------------------------------------------------
	MCALL CORE5277_FLAG_GET											;TODO Что если в перрывании поменяется флаг?
	BRNE PC+0x03														;TODO Может блокировать прерывания?
	MJMP CORE5277_FLAG_WAIT_HI
	MJMP CORE5277_FLAG_WAIT_LO
.endif
