;-----------------------------------------------------------------------------------------------------------------------
;Владельцем данного исходного кода является Удовиченко Константин Александрович, емайл:w5277c@gmail.com, по всем
;правовым вопросам обращайтесь на email.
;-----------------------------------------------------------------------------------------------------------------------
;07.10.2019  w5277c@gmail.com        Начало
;04.08.2020  w5277c@gmail.com        Разбиение на файлы
;-----------------------------------------------------------------------------------------------------------------------
.ifdef DEF_CORE5277_FLAG_GET
.else
.set DEF_CORE5277_FLAG_GET = 1

.include	"./inc/core/_flag_offset.inc"
.include	"./inc/conv/bitnum_to_num.inc"

;--------------------------------------------------------
CORE5277_FLAG_GET:
;--------------------------------------------------------
;Получение флага
;IN:TEMP - номер флага(0-63)
;OUT: флаг Z(HI flag Z=0)
;--------------------------------------------------------
	PUSH_Z
	PUSH ACCUM
	PUSH TEMP

	MCALL _CORE5277_FLAG_OFFSET
	ANDI TEMP,0x07
	MCALL CORE5277_BITNUM_TO_NUM
	LD ACCUM,Z
	AND ACCUM,TEMP

	POP TEMP
	POP ACCUM
	POP_Z
	RET
.endif
