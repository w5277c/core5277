;-----------------------------------------------------------------------------------------------------------------------
;Владельцем данного исходного кода является Удовиченко Константин Александрович, емайл:w5277c@gmail.com, по всем
;правовым вопросам обращайтесь на email.
;-----------------------------------------------------------------------------------------------------------------------
;07.10.2019  w5277c@gmail.com        Начало
;09.08.2020  w5277c@gmail.com        Разбиение на файлы
;-----------------------------------------------------------------------------------------------------------------------
.ifdef DEF_CORE5277_WAIT
.else
.set DEF_CORE5277_WAIT = 1

.include "./inc/core/wait_2ms.inc"

;--------------------------------------------------------
CORE5277_WAIT:
;--------------------------------------------------------
;Ждем 3 кванта времени
;--------------------------------------------------------
	PUSH TEMP_H
	;Не делаем WAIT если диспетчер заблокирован
	LDI TEMP_H,0x00
	CP _CORE5277_DISPATCHER_LOCK_CNTR,TEMP_H
	BRNE _CORE5277_WAIT__DISPATCHER_LOCKED
	PUSH TEMP_L
	PUSH TEMP
	LDI TEMP_H,0x00
	LDI TEMP_L,0x00
	LDI TEMP,0x03
	MCALL CORE5277_WAIT_2MS
	POP TEMP
	POP TEMP_L
_CORE5277_WAIT__DISPATCHER_LOCKED:
	POP TEMP_H
	RET
.endif
