;-----------------------------------------------------------------------------------------------------------------------
;Файл распространяется под лицензией GPL-3.0-or-later, https://www.gnu.org/licenses/gpl-3.0.txt
;-----------------------------------------------------------------------------------------------------------------------
;07.10.2019  w5277c@gmail.com        Начало
;04.08.2020  w5277c@gmail.com        Разбиение на файлы
;27.10.2020  w5277c@gmail.com        Обновлена информация об авторских правах
;-----------------------------------------------------------------------------------------------------------------------
.ifdef DEF__C5_FLAG_OFFSET
.else
.set DEF__C5_FLAG_OFFSET = 1

;--------------------------------------------------------
_C5_FLAG_OFFSET:
;--------------------------------------------------------
;Возвращаем смещение на необходимые флаги
;IN:TEMP - номер флага(0-63)
;OUT:Z - смещение
;--------------------------------------------------------
	PUSH TEMP
	LSR TEMP
	LSR TEMP
	LSR TEMP
	LDI ZH,high(_C5_FLAGS)
	LDI ZL,low(_C5_FLAGS)
	ADD ZL,TEMP
	CLR TEMP
	ADC ZH,TEMP
	POP TEMP
	RET
.endif
