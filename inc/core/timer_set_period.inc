;-----------------------------------------------------------------------------------------------------------------------
;Файл распространяется под лицензией GPL-3.0-or-later, https://www.gnu.org/licenses/gpl-3.0.txt
;-----------------------------------------------------------------------------------------------------------------------
;20.10.2020  w5277c@gmail.com        Начало
;27.10.2020  w5277c@gmail.com        Обновлена информация об авторских правах
;-----------------------------------------------------------------------------------------------------------------------
.ifndef DEF_C5_TIMER_SET_PERIOD
.set DEF_C5_TIMER_SET_PERIOD = 1

;--------------------------------------------------------
C5_TIMER_SET_PERIOD:
;--------------------------------------------------------
;переназначение периода таймера
;IN: TEMP - номер таймера(0-...),
;ACCUM - кол-во итераций:
;7-й бит включен - итерация по 0.002c иначе по 0.000 050с
;диапазон значений 0x01-0x7f
;--------------------------------------------------------
	PUSH_Z
	PUSH TEMP
	PUSH ACCUM

	MOV ZL,TEMP
	LSL TEMP
	LSL TEMP
	ADD TEMP,ZL

	LDI ZH,high(_C5_TIMERS)
	LDI ZL,low(_C5_TIMERS)
	ADD ZL,TEMP
	CLR TEMP
	ADC ZH,TEMP

	STD Z+_C5_TIMER_PROC_ID,PID
	STD Z+_C5_TIMER_DEFAULT,ACCUM
	ANDI ACCUM,0x7f
	STD Z+_C5_TIMER_CNTR,ACCUM

	POP ACCUM
	POP TEMP
	POP_Z
	RET
.endif
