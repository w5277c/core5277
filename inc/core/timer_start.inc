;-----------------------------------------------------------------------------------------------------------------------
;Файл распространяется под лицензией GPL-3.0-or-later, https://www.gnu.org/licenses/gpl-3.0.txt
;-----------------------------------------------------------------------------------------------------------------------
;07.10.2019  w5277c@gmail.com        Начало
;09.08.2020  w5277c@gmail.com        Разбиение на файлы
;19.08.2020  w5277c@gmail.com        Отсчет с нуля
;20.10.2020  w5277c@gmail.com        Убран параметр периода, вынесен в отдельную процедуру
;27.10.2020  w5277c@gmail.com        Обновлена информация об авторских правах
;-----------------------------------------------------------------------------------------------------------------------
.ifdef DEF_C5_TIMER_START
.else
.set DEF_C5_TIMER_START = 1

;--------------------------------------------------------
C5_TIMER_START:
;--------------------------------------------------------
;Запуск таймера
;IN: PID,TEMP - номер таймера(0-...),
;--------------------------------------------------------
	PUSH_Z
	PUSH TEMP

	MOV ZL,TEMP
	LSL TEMP
	LSL TEMP
	ADD TEMP,ZL

	LDI ZH,high(_C5_TIMERS)
	LDI ZL,low(_C5_TIMERS)
	ADD ZL,TEMP
	CLR TEMP
	ADC ZH,TEMP

	STD Z+_C5_TIMER_PROC_ID,PID

	POP TEMP
	POP_Z
	RET
.endif
