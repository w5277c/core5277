;-----------------------------------------------------------------------------------------------------------------------
;Файл распространяется под лицензией GPL-3.0-or-later, https://www.gnu.org/licenses/gpl-3.0.txt
;-----------------------------------------------------------------------------------------------------------------------
;07.10.2019  w5277c@gmail.com        Начало
;04.08.2020  w5277c@gmail.com        Разбиение на файлы
;27.10.2020  w5277c@gmail.com        Обновлена информация об авторских правах
;-----------------------------------------------------------------------------------------------------------------------
.ifdef DEF_C5_FLAG_INVERT
.else
.set DEF_C5_FLAG_INVERT = 1

.include	"./inc/core/flag_get.inc"
.include	"./inc/core/flag_set.inc"
.include	"./inc/core/flag_reset.inc"

;--------------------------------------------------------
C5_FLAG_INVERT:
;--------------------------------------------------------
;Инвертирование флага
;IN:TEMP - номер флага(0-63)
;--------------------------------------------------------
	MCALL C5_FLAG_GET											;TODO Что если в перрывании поменяется флаг?
	BRNE PC+0x03														;TODO Может блокировать прерывания?
	MJMP C5_FLAG_SET
	MJMP C5_FLAG_RESET
.endif
