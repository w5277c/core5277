;-----------------------------------------------------------------------------------------------------------------------
;Файл распространяется под лицензией GPL-3.0-or-later, https://www.gnu.org/licenses/gpl-3.0.txt
;-----------------------------------------------------------------------------------------------------------------------
;07.10.2019  w5277c@gmail.com        Начало
;09.08.2020  w5277c@gmail.com        Разбиение на файлы
;19.08.2020  w5277c@gmail.com        Отсчет с нуля
;27.10.2020  w5277c@gmail.com        Обновлена информация об авторских правах
;-----------------------------------------------------------------------------------------------------------------------
.ifndef DEF_C5_TIMER_STOP
.set DEF_C5_TIMER_STOP = 1

;--------------------------------------------------------
C5_TIMER_STOP:
;--------------------------------------------------------
;Останов таймера
;IN TEMP - номер таймера(0-...)
;--------------------------------------------------------
	PUSH_Z
	PUSH TEMP

	MOV ZL,TEMP
	LSL TEMP
	LSL TEMP
	ADD TEMP,ZL

	LDI ZH,high(_C5_TIMERS)
	LDI ZL,low(_C5_TIMERS)
	ADD ZL,TEMP
	CLR TEMP
	ADC ZH,TEMP

	LDI TEMP,0xff
	STD Z+_C5_TIMER_PROC_ID,TEMP

	POP TEMP
	POP_Z
	RET
.endif
