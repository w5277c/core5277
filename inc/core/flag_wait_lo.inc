;-----------------------------------------------------------------------------------------------------------------------
;Владельцем данного исходного кода является Удовиченко Константин Александрович, емайл:w5277c@gmail.com, по всем
;правовым вопросам обращайтесь на email.
;-----------------------------------------------------------------------------------------------------------------------
;07.10.2019  w5277c@gmail.com        Начало
;04.08.2020  w5277c@gmail.com        Разбиение на файлы
;-----------------------------------------------------------------------------------------------------------------------
.ifdef DEF_CORE5277_FLAG_WAIT_LO
.else
.set DEF_CORE5277_FLAG_WAIT_LO = 1

.include	"./inc/core/flag_get.inc"
.include	"./inc/core/wait.inc"

;--------------------------------------------------------
CORE5277_FLAG_WAIT_LO:
;--------------------------------------------------------
;Ожидание состояния флага в состоянии LO
;IN:TEMP - номер флага(0-63)
;--------------------------------------------------------
	MCALL CORE5277_FLAG_GET
	BRNE PC+0x02
	RET

	;Проверка на вызванную процедуру из прерывания
	CPI _PID,0xff
	BREQ CORE5277_FLAG_WAIT_LO
	;Спим некоторое время
	MCALL CORE5277_WAIT
	RJMP CORE5277_FLAG_WAIT_LO
.endif
