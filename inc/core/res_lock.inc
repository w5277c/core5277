;-----------------------------------------------------------------------------------------------------------------------
;Файл распространяется под лицензией GPL-3.0-or-later, https://www.gnu.org/licenses/gpl-3.0.txt
;-----------------------------------------------------------------------------------------------------------------------
;07.10.2019  w5277c@gmail.com        Начало
;04.08.2020  w5277c@gmail.com        Разбиение на файлы
;27.10.2020  w5277c@gmail.com        Обновлена информация об авторских правах
;-----------------------------------------------------------------------------------------------------------------------
.ifdef DEF_C5_RES_LOCK
.else
.set DEF_C5_RES_LOCK = 1

.include	"./inc/core/res_wait_n_lock.inc"

;--------------------------------------------------------
C5_RES_LOCK:
;--------------------------------------------------------
;Занимаем ресурс
;IN:ACCUM - ID ресурса
;OUT:флаг Z - результат(HI - успех)
;--------------------------------------------------------
	PUSH TEMP_H
	PUSH TEMP_L
	PUSH TEMP
	LDI TEMP_H,0x00
	LDI TEMP_L,0x00
	LDI TEMP,0x03
	MCALL C5_RES_WAIT_N_LOCK
	POP TEMP
	POP TEMP_L
	POP TEMP_H
	RET
.endif
