;-----------------------------------------------------------------------------------------------------------------------
;Владельцем данного исходного кода является Удовиченко Константин Александрович, емайл:w5277c@gmail.com, по всем
;правовым вопросам обращайтесь на email.
;-----------------------------------------------------------------------------------------------------------------------
;12.06.2020  w5277c@gmail.com        Начало
;02.08.2020  w5277c@gmail.com        Разбиение на файлы
;-----------------------------------------------------------------------------------------------------------------------
.ifdef DEF_CORE5277_LOG_ROMSTR
.else
.set DEF_CORE5277_LOG_ROMSTR = 1
.ifdef LOGGING_PORT

.include	"./inc/io/log_str.inc"

.MACRO CORE5277_LOG_ROMSTR
	PUSH YH
	PUSH YL
	LDI YH,high(@0)|0x80
	LDI YL,low(@0)
	MCALL CORE5277_LOG_STR
	POP YL
	POP YH
.ENDMACRO
.endif
.endif
