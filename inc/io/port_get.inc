;-----------------------------------------------------------------------------------------------------------------------
;Файл распространяется под лицензией GPL-3.0-or-later, https://www.gnu.org/licenses/gpl-3.0.txt
;-----------------------------------------------------------------------------------------------------------------------
;05.03.2020  w5277c@gmail.com        Начало
;01.08.2020  w5277c@gmail.com        Разбиение на файлы
;27.10.2020  w5277c@gmail.com        Обновлена информация об авторских правах
;-----------------------------------------------------------------------------------------------------------------------
.ifndef DEF_C5_PORT_GET
.set DEF_C5_PORT_GET = 1

.include	"./inc/io/port_offsets.inc"

;--------------------------------------------------------
C5_PORT_GET:
;--------------------------------------------------------
;Считывание состояния порта
;IN: ACCUM сдвоенный порт, исп. только старший ниббл
;OUT: flag С - состояние порта(true = HI)
;--------------------------------------------------------
	PUSH_Z
	PUSH TEMP_H
	PUSH TEMP_L
	PUSH TEMP
	PUSH ACCUM

	MCALL C5_PORT_OFFSETS
	CLR ZH
	MOV ZL,TEMP
	LD TEMP,Z
	CLC
	AND TEMP,ACCUM
	BREQ PC+0x02
	SEC

	POP ACCUM
	POP TEMP
	POP TEMP_L
	POP TEMP_H
	POP_Z
	RET
.endif
