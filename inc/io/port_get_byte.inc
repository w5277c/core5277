;-----------------------------------------------------------------------------------------------------------------------
;Файл распространяется под лицензией GPL-3.0-or-later, https://www.gnu.org/licenses/gpl-3.0.txt
;-----------------------------------------------------------------------------------------------------------------------
;05.03.2020  w5277c@gmail.com        Начало
;01.08.2020  w5277c@gmail.com        Разбиение на файлы
;27.10.2020  w5277c@gmail.com        Обновлена информация об авторских правах
;-----------------------------------------------------------------------------------------------------------------------
.ifdef DEF_C5_PORT_GET_BYTE
.else
.set DEF_C5_PORT_GET_BYTE = 1

.include	"./inc/io/port_offsets.inc"

;--------------------------------------------------------
C5_PORT_GET_BYTE:
;--------------------------------------------------------
;Считывание состояния порта(8 бит)
;IN: ACCUM - порт
;OUT: ACCUM - значение
;--------------------------------------------------------
	PUSH_Z
	PUSH TEMP_H
	PUSH TEMP_L
	PUSH TEMP

	MCALL C5_PORT_OFFSETS
	MOV ZL,TEMP
	LDI ZH,0x00
	LD ACCUM,Z

	POP TEMP
	POP TEMP_L
	POP TEMP_H
	POP_Z
	RET
.endif
