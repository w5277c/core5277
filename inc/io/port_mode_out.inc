;-----------------------------------------------------------------------------------------------------------------------
;Файл распространяется под лицензией GPL-3.0-or-later, https://www.gnu.org/licenses/gpl-3.0.txt
;-----------------------------------------------------------------------------------------------------------------------
;05.03.2020  w5277c@gmail.com        Начало
;01.08.2020  w5277c@gmail.com        Разбиение на файлы
;03.10.2020  w5277c@gmail.com        Атомарность
;27.10.2020  w5277c@gmail.com        Обновлена информация об авторских правах
;-----------------------------------------------------------------------------------------------------------------------
.ifdef DEF_C5_PORT_MODE_OUT
.else
.set DEF_C5_PORT_MODE_OUT = 1

.include	"./inc/io/port_offsets.inc"

;--------------------------------------------------------
C5_PORT_MODE_OUT:
;--------------------------------------------------------
;Устанвливаем порт на выход
;IN: ACCUM - порт
;--------------------------------------------------------
	PUSH_Z
	PUSH TEMP_H
	PUSH TEMP_L
	PUSH TEMP
	PUSH ACCUM

	MCALL C5_PORT_OFFSETS
	CLR ZH
	MOV ZL,TEMP_L

	LDS TEMP_L,SREG
	CLI
	LD TEMP,Z
	OR TEMP,ACCUM
	ST Z,TEMP
	STS SREG,TEMP_L

	POP ACCUM
	POP TEMP
	POP TEMP_L
	POP TEMP_H
	POP_Z
	RET
.endif
