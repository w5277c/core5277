;-----------------------------------------------------------------------------------------------------------------------
;Владельцем данного исходного кода является Удовиченко Константин Александрович, емайл:w5277c@gmail.com, по всем
;правовым вопросам обращайтесь на email.
;-----------------------------------------------------------------------------------------------------------------------
;12.06.2020  w5277c@gmail.com        Начало
;01.08.2020  w5277c@gmail.com        Разбиение на файлы
;13.09.2020  w5277c@gmail.com        Восстанавливаем Y
;-----------------------------------------------------------------------------------------------------------------------
.ifdef DEF_CORE5277_LOG_BYTES
.else
.set DEF_CORE5277_LOG_BYTES = 1
.ifdef LOGGING_PORT

.include	"./inc/io/log_byte.inc"

;--------------------------------------------------------
CORE5277_LOG_BYTES:
;--------------------------------------------------------
;Логируем блок данных
;IN: Y - адрес начала блока, TEMP - длина блока
;--------------------------------------------------------
	PUSH TEMP
	PUSH LOOP_CNTR
	PUSH_Y
	MOV LOOP_CNTR,TEMP
_CORE5277_LOG_BYTES__LOOP:
	LD TEMP,Y+
	MCALL CORE5277_LOG_BYTE
	DEC LOOP_CNTR
	BRNE _CORE5277_LOG_BYTES__LOOP

	POP_Y
	POP LOOP_CNTR
	POP TEMP
	RET
.endif
.endif
