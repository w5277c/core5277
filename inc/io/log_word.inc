;-----------------------------------------------------------------------------------------------------------------------
;Владельцем данного исходного кода является Удовиченко Константин Александрович, емайл:w5277c@gmail.com, по всем
;правовым вопросам обращайтесь на email.
;-----------------------------------------------------------------------------------------------------------------------
;12.06.2020  w5277c@gmail.com        Начало
;01.08.2020  w5277c@gmail.com        Разбиение на файлы
;-----------------------------------------------------------------------------------------------------------------------
.ifdef DEF_CORE5277_LOG_WORD
.else
.set DEF_CORE5277_LOG_WORD = 1
.ifdef LOGGING_PORT

.include	"./inc/io/log_byte.inc"

;--------------------------------------------------------
CORE5277_LOG_WORD:
;--------------------------------------------------------
;Логирование слова как HEX строки
;IN: TEMP_H/TEMP_L - слово
;--------------------------------------------------------
	PUSH TEMP
	MOV TEMP,TEMP_H
	MCALL CORE5277_LOG_BYTE
	MOV TEMP,TEMP_L
	MCALL CORE5277_LOG_BYTE
	POP TEMP
	RET
.endif
.endif
