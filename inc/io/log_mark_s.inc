;-----------------------------------------------------------------------------------------------------------------------
;Владельцем данного исходного кода является Удовиченко Константин Александрович, емайл:w5277c@gmail.com, по всем
;правовым вопросам обращайтесь на email.
;-----------------------------------------------------------------------------------------------------------------------
;12.06.2020  w5277c@gmail.com        Начало
;02.08.2020  w5277c@gmail.com        Разбиение на файлы
;-----------------------------------------------------------------------------------------------------------------------
.ifdef DEF_CORE5277_LOG_MARK_S
.else
.set DEF_CORE5277_LOG_MARK_S = 1
.ifdef LOGGING_PORT

.include	"./inc/io/log_char.inc"

.MACRO CORE5277_LOG_MARK_S
	PUSH TEMP
	LDI TEMP,@0
	MCALL CORE5277_LOG_CHAR
	POP TEMP
.ENDMACRO
.endif
.endif
