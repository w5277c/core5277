;-----------------------------------------------------------------------------------------------------------------------
;Владельцем данного исходного кода является Удовиченко Константин Александрович, емайл:w5277c@gmail.com, по всем
;правовым вопросам обращайтесь на email.
;-----------------------------------------------------------------------------------------------------------------------
;05.03.2020  w5277c@gmail.com        Начало
;01.08.2020  w5277c@gmail.com        Разбиение на файлы
;03.10.2020  w5277c@gmail.com        Атомарность
;-----------------------------------------------------------------------------------------------------------------------
.ifdef DEF_CORE5277_PORT_MODE_IN
.else
.set DEF_CORE5277_PORT_MODE_IN = 1

.include	"./inc/io/port_offsets.inc"

;--------------------------------------------------------
CORE5277_PORT_MODE_IN:
;--------------------------------------------------------
;Устанвливаем порт на вход
;IN: ACCUM - порт
;--------------------------------------------------------
	PUSH_Z
	PUSH TEMP_H
	PUSH TEMP_L
	PUSH TEMP
	PUSH ACCUM

	MCALL CORE5277_PORT_OFFSETS
	CLR ZH
	MOV ZL,TEMP_L

	LDS TEMP_L,SREG
	CLI
	LD TEMP,Z
	COM ACCUM
	AND TEMP,ACCUM
	ST Z,TEMP
	STS SREG,TEMP_L

	POP ACCUM
	POP TEMP
	POP TEMP_L
	POP TEMP_H
	POP_Z
	RET
.endif
