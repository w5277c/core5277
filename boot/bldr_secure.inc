;-----------------------------------------------------------------------------------------------------------------------
;Файл распространяется под лицензией GPL-3.0-or-later, https://www.gnu.org/licenses/gpl-3.0.txt
;-----------------------------------------------------------------------------------------------------------------------
;03.03.2021  w5277c@gmail.com			Начало
;-----------------------------------------------------------------------------------------------------------------------
.ifdef DEF_BOOTLADER_SECURE
.error "Bootloader secure already included!"
.else
.set DEF_BOOTLADER_SECURE = 1

.if REPORT_INCLUDES == 0x01
.message "included BLDR SECURE"
.endif

	.EQU	EEPROM_BLDR_SECURE_DATA_SIZE				= 0x00	; Длина данных в EEPROM для расшифровки прошивки

;--------------------------------------------------------
.MACRO _BLDR_SECURE
;--------------------------------------------------------
;Процедура выполняет расшифровку зашифрованной FLASH
;страницы
;IN: Y-адрес начала блока данных FLASH страницы в RAM,
;X-адрес в EEPROM на блок SECURE_DATA
;ACCUM-регистр с номером страницы, размер страницы задан
;константой FLASH_SIZE(байты) в файле устройства
;--------------------------------------------------------
	;TODO просто заглушка
.ENDMACRO
