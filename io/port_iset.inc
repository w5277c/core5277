;-----------------------------------------------------------------------------------------------------------------------
;Файл распространяется под лицензией GPL-3.0-or-later, https://www.gnu.org/licenses/gpl-3.0.txt
;-----------------------------------------------------------------------------------------------------------------------
;13.12.2020	w5277c@gmail.com			Начало
;-----------------------------------------------------------------------------------------------------------------------
.ifdef DEF_PORT_ISET
.else
.set DEF_PORT_ISET = 1

.if REPORT_INCLUDES == 0x01
.message "included PORT_ISET"
.endif

.include	"./io/port_set_hi.inc"
.include	"./io/port_set_lo.inc"

;--------------------------------------------------------
PORT_ISET:
;--------------------------------------------------------
;Установка инвертированного состояния порта
;IN: ACCUM - порт
;flag C - состояние порта(true = LO)
;--------------------------------------------------------
	BRCC PC+0x03
	MJMP PORT_SET_LO
	MJMP PORT_SET_HI
.endif
