;-----------------------------------------------------------------------------------------------------------------------
;Файл распространяется под лицензией GPL-3.0-or-later, https://www.gnu.org/licenses/gpl-3.0.txt
;-----------------------------------------------------------------------------------------------------------------------
;29.01.2021  w5277c@gmail.com			Начало
;-----------------------------------------------------------------------------------------------------------------------
.ifdef DEF_INPUT_GET_CHAR
.else
.set DEF_INPUT_GET_CHAR = 1

.include	"./core/wait.inc"

;Ожидает символ с порта по методу UART.
;BAUDRATE идентичен логированию.
;Если порт поддержтвает внешние прерывания(INT0,...),
;то при ожидании старта прерывания будут разрешены,
;диспетчер также не блокируется. Т.е. многопоточность
;не нарушается.
;Во время приема октета все прерывания запрещаются.
;Полученный символ записывается в выделенную ячейку
;памяти ядра
;Если порт не поддерживает внешние прерывания,
;то вся деятельность ядра будет полностью остановлена
;пока не будет получен символ.
;Для корректной работы все остальные обработчики
;прерываний должны разрешать внешние прерывания,
;что бы попасть в данный обработчик максимально быстро.

;TODO добавить блокировку ресурса
;--------------------------------------------------------
INPUT_GET_CHAR:
;Считываем с символ в виде UART RX
;OUT: TEMP-символ
;--------------------------------------------------------
.ifdef INPUT_PORT
	PUSH ACCUM

_INPUT_GET_CHAR__REPEATE:
.if		INPUT_PORT == INT0_PORT
	LDI ACCUM,C5_IR_INT0
	PUSH TEMP_H
	PUSH TEMP_L
	LDI TEMP_H,high(_INPUT_GET_CHAR__GOT_START)
	LDI TEMP_L,low(_INPUT_GET_CHAR__GOT_START)
	MCALL C5_IR_VECTOR_SET
	POP TEMP_L
	POP TEMP_H
	LDS ACCUM,SREG
	CLI
	LDS TEMP,EICRA
	ANDI TEMP,~((1<<ISC00)|(1<<ISC01))
	ORI TEMP,C5_ISC_FALLING_EDGE
	STS EICRA,TEMP
	LDS TEMP,EIFR
	ORI TEMP,(1<<INTF0)
	STS EIFR,TEMP
	LDS TEMP,EIMSK
	ORI TEMP,(1<<INT0)
	STS EIMSK,TEMP
	CLR TEMP
	STS _C5_INPUT_CHAR,TEMP
	STS SREG,ACCUM

	MCALL C5_WAIT
	LDS TEMP,_C5_INPUT_CHAR
	TST TEMP
	BREQ PC-0x05
	POP ACCUM
	RET
.elseif	INPUT_PORT == INT1_PORT
	LDI ACCUM,C5_IR_INT1
	PUSH TEMP_H
	PUSH TEMP_L
	LDI TEMP_H,high(_INPUT_GET_CHAR__GOT_START)
	LDI TEMP_L,low(_INPUT_GET_CHAR__GOT_START)
	MCALL C5_IR_VECTOR_SET
	POP TEMP_L
	POP TEMP_H
	LDS ACCUM,SREG
	CLI
	LDS TEMP,EICRA
	ANDI TEMP,~((1<<ISC10)|(1<<ISC11))
	ORI TEMP,C5_ISC_FALLING_EDGE
	STS EICRA,TEMP
	LDS TEMP,EIFR
	ORI TEMP,(1<<INTF1)
	STS EIFR,TEMP
	LDS TEMP,EIMSK
	ORI TEMP,(1<<INT1)
	STS EIMSK,TEMP
	CLR TEMP
	STS _C5_INPUT_CHAR,TEMP
	STS SREG,ACCUM

	MCALL C5_WAIT
	LDS TEMP,_C5_INPUT_CHAR
	TST TEMP
	BREQ PC-0x05
	POP ACCUM
	RET
.elseif	INPUT_PORT == INT2_PORT
	LDI ACCUM,C5_IR_INT2
	PUSH TEMP_H
	PUSH TEMP_L
	LDI TEMP_H,high(_INPUT_GET_CHAR__GOT_START)
	LDI TEMP_L,low(_INPUT_GET_CHAR__GOT_START)
	MCALL C5_IR_VECTOR_SET
	POP TEMP_L
	POP TEMP_H
	LDS ACCUM,SREG
	CLI
	LDS TEMP,EICRA
	ANDI TEMP,~((1<<ISC20)|(1<<ISC21))
	ORI TEMP,C5_ISC_FALLING_EDGE
	STS EICRA,TEMP
	LDS TEMP,EIFR
	ORI TEMP,(1<<INTF2)
	STS EIFR,TEMP
	LDS TEMP,EIMSK
	ORI TEMP,(1<<INT2)
	STS EIMSK,TEMP
	CLR TEMP
	STS _C5_INPUT_CHAR,TEMP
	STS SREG,ACCUM

	MCALL C5_WAIT
	LDS TEMP,_C5_INPUT_CHAR
	TST TEMP
	BREQ PC-0x05
	POP ACCUM
	RET
.elseif	INPUT_PORT == INT3_PORT
	LDI ACCUM,C5_IR_INT3
	PUSH TEMP_H
	PUSH TEMP_L
	LDI TEMP_H,high(_INPUT_GET_CHAR__GOT_START)
	LDI TEMP_L,low(_INPUT_GET_CHAR__GOT_START)
	MCALL C5_IR_VECTOR_SET
	POP TEMP_L
	POP TEMP_H
	LDS ACCUM,SREG
	CLI
	LDS TEMP,EICRA
	ANDI TEMP,~((1<<ISC30)|(1<<ISC31))
	ORI TEMP,C5_ISC_FALLING_EDGE
	STS EICRA,TEMP
	LDS TEMP,EIFR
	ORI TEMP,(1<<INTF3)
	STS EIFR,TEMP
	LDS TEMP,EIMSK
	ORI TEMP,(1<<INT3)
	STS EIMSK,TEMP
	CLR TEMP
	STS _C5_INPUT_CHAR,TEMP
	STS SREG,ACCUM

	MCALL C5_WAIT
	LDS TEMP,_C5_INPUT_CHAR
	TST TEMP
	BREQ PC-0x05
	POP ACCUM
	RET
.elseif	INPUT_PORT == INT4_PORT
	LDI ACCUM,C5_IR_INT4
	PUSH TEMP_H
	PUSH TEMP_L
	LDI TEMP_H,high(_INPUT_GET_CHAR__GOT_START)
	LDI TEMP_L,low(_INPUT_GET_CHAR__GOT_START)
	MCALL C5_IR_VECTOR_SET
	POP TEMP_L
	POP TEMP_H
	LDS ACCUM,SREG
	CLI
	LDS TEMP,EICRB
	ANDI TEMP,~((1<<ISC40)|(1<<ISC41))
	ORI TEMP,C5_ISC_FALLING_EDGE
	STS EICRB,TEMP
	LDS TEMP,EIFR
	ORI TEMP,(1<<INTF4)
	STS EIFR,TEMP
	LDS TEMP,EIMSK
	ORI TEMP,(1<<INT4)
	STS EIMSK,TEMP
	CLR TEMP
	STS _C5_INPUT_CHAR,TEMP
	STS SREG,ACCUM

	MCALL C5_WAIT
	LDS TEMP,_C5_INPUT_CHAR
	TST TEMP
	BREQ PC-0x05
	POP ACCUM
	RET
.elseif	INPUT_PORT == INT5_PORT
	LDI ACCUM,C5_IR_INT5
	PUSH TEMP_H
	PUSH TEMP_L
	LDI TEMP_H,high(_INPUT_GET_CHAR__GOT_START)
	LDI TEMP_L,low(_INPUT_GET_CHAR__GOT_START)
	MCALL C5_IR_VECTOR_SET
	POP TEMP_L
	POP TEMP_H
	LDS ACCUM,SREG
	CLI
	LDS TEMP,EICRB
	ANDI TEMP,~((1<<ISC50)|(1<<ISC51))
	ORI TEMP,C5_ISC_FALLING_EDGE
	STS EICRB,TEMP
	LDS TEMP,EIFR
	ORI TEMP,(1<<INTF5)
	STS EIFR,TEMP
	LDS TEMP,EIMSK
	ORI TEMP,(1<<INT5)
	STS EIMSK,TEMP
	CLR TEMP
	STS _C5_INPUT_CHAR,TEMP
	STS SREG,ACCUM

	MCALL C5_WAIT
	LDS TEMP,_C5_INPUT_CHAR
	TST TEMP
	BREQ PC-0x05
	POP ACCUM
	RET
.elseif	INPUT_PORT == INT6_PORT
	LDI ACCUM,C5_IR_INT6
	PUSH TEMP_H
	PUSH TEMP_L
	LDI TEMP_H,high(_INPUT_GET_CHAR__GOT_START)
	LDI TEMP_L,low(_INPUT_GET_CHAR__GOT_START)
	MCALL C5_IR_VECTOR_SET
	POP TEMP_L
	POP TEMP_H
	LDS ACCUM,SREG
	CLI
	LDS TEMP,EICRB
	ANDI TEMP,~((1<<ISC60)|(1<<ISC61))
	ORI TEMP,C5_ISC_FALLING_EDGE
	STS EICRB,TEMP
	LDS TEMP,EIFR
	ORI TEMP,(1<<INTF6)
	STS EIFR,TEMP
	LDS TEMP,EIMSK
	ORI TEMP,(1<<INT6)
	STS EIMSK,TEMP
	CLR TEMP
	STS _C5_INPUT_CHAR,TEMP
	STS SREG,ACCUM

	MCALL C5_WAIT
	LDS TEMP,_C5_INPUT_CHAR
	TST TEMP
	BREQ PC-0x05
	POP ACCUM
	RET
.elseif	INPUT_PORT == INT7_PORT
	LDI ACCUM,C5_IR_INT7
	PUSH TEMP_H
	PUSH TEMP_L
	LDI TEMP_H,high(_INPUT_GET_CHAR__GOT_START)
	LDI TEMP_L,low(_INPUT_GET_CHAR__GOT_START)
	MCALL C5_IR_VECTOR_SET
	POP TEMP_L
	POP TEMP_H
	LDS ACCUM,SREG
	CLI
	LDS TEMP,EICRB
	ANDI TEMP,~((1<<ISC70)|(1<<ISC71))
	ORI TEMP,C5_ISC_FALLING_EDGE
	STS EICRB,TEMP
	LDS TEMP,EIFR
	ORI TEMP,(1<<INTF7)
	STS EIFR,TEMP
	LDS TEMP,EIMSK
	ORI TEMP,(1<<INT7)
	STS EIMSK,TEMP
	CLR TEMP
	STS _C5_INPUT_CHAR,TEMP
	STS SREG,ACCUM

	MCALL C5_WAIT
	LDS TEMP,_C5_INPUT_CHAR
	TST TEMP
	BREQ PC-0x05
	POP ACCUM
	RET
.else
	PUSH_Z
	LDI ZH,high(PORTS_TABLE*2+(((INPUT_PORT>>4)*0x03)+0x02))
	LDI ZL,low(PORTS_TABLE*2+(((INPUT_PORT>>4)*0x03)+0x02))
	LPM ZL,Z
	CLR ZH

	CLI
_INPUT_GET_CHAR__WAIT_START:
	LD TEMP,Z
	ANDI TEMP,EXP2 (INPUT_PORT & 0x0f)
	BRNE _INPUT_GET_CHAR__WAIT_START
	POP_Z

	LDI ACCUM,0x13;0x08
	DEC ACCUM
	BRNE PC-0x01
	POP ACCUM
.endif
_INPUT_GET_CHAR__GOT_START:										;Одновременно точка входа в обработчик прерывания
	PUSH ACCUM
	PUSH TEMP
	PUSH_Z

	LDI ZH,high(PORTS_TABLE*2+(((INPUT_PORT>>4)*0x03)+0x02))
	LDI ZL,low(PORTS_TABLE*2+(((INPUT_PORT>>4)*0x03)+0x02))
	LPM ZL,Z
	CLR ZH

	;DATA BITS
	PUSH LOOP_CNTR
	LDI LOOP_CNTR,0x08
_INPUT_GET_CHAR__BITES_LOOP:
	LSR TEMP
	LD ACCUM,Z
	NOP
	NOP
	NOP
	ANDI ACCUM,EXP2 (INPUT_PORT & 0x0f)
	BREQ PC+0x02
	ORI TEMP,0x80
	LDI ACCUM,0x14;0x08
	DEC ACCUM
	BRNE PC-0x01
	DEC LOOP_CNTR
	BRNE _INPUT_GET_CHAR__BITES_LOOP
	POP LOOP_CNTR

	LD ACCUM,Z
	POP_Z
	ANDI ACCUM,EXP2 (INPUT_PORT & 0x0f)
.if	INPUT_PORT == INT0_PORT
	BREQ PC+0x08
	STS _C5_INPUT_CHAR,TEMP
	LDS TEMP,EIMSK
	ANDI TEMP,~(1<<INT0)
	STS EIMSK,TEMP
	LDS TEMP,EIFR
	ORI TEMP,(1<<INTF0)
	STS EIFR,TEMP
	POP TEMP
	POP ACCUM
	RET
.elseif	INPUT_PORT == INT1_PORT
	BREQ PC+0x08
	STS _C5_INPUT_CHAR,TEMP
	LDS TEMP,EIMSK
	ANDI TEMP,~(1<<INT1)
	STS EIMSK,TEMP
	LDS TEMP,EIFR
	ORI TEMP,(1<<INTF1)
	STS EIFR,TEMP
	POP TEMP
	POP ACCUM
	RET
.elseif	INPUT_PORT == INT2_PORT
	BREQ PC+0x08
	STS _C5_INPUT_CHAR,TEMP
	LDS TEMP,EIMSK
	ANDI TEMP,~(1<<INT2)
	STS EIMSK,TEMP
	LDS TEMP,EIFR
	ORI TEMP,(1<<INTF2)
	STS EIFR,TEMP
	POP TEMP
	POP ACCUM
	RET
.elseif	INPUT_PORT == INT3_PORT
	BREQ PC+0x08
	STS _C5_INPUT_CHAR,TEMP
	LDS TEMP,EIMSK
	ANDI TEMP,~(1<<INT3)
	STS EIMSK,TEMP
	LDS TEMP,EIFR
	ORI TEMP,(1<<INTF3)
	STS EIFR,TEMP
	POP TEMP
	POP ACCUM
	RET
.elseif	INPUT_PORT == INT4_PORT
	BREQ PC+0x08
	STS _C5_INPUT_CHAR,TEMP
	LDS TEMP,EIMSK
	ANDI TEMP,~(1<<INT4)
	STS EIMSK,TEMP
	LDS TEMP,EIFR
	ORI TEMP,(1<<INTF4)
	STS EIFR,TEMP
	POP TEMP
	POP ACCUM
	RET
.elseif	INPUT_PORT == INT5_PORT
	BREQ PC+0x08
	STS _C5_INPUT_CHAR,TEMP
	LDS TEMP,EIMSK
	ANDI TEMP,~(1<<INT5)
	STS EIMSK,TEMP
	LDS TEMP,EIFR
	ORI TEMP,(1<<INTF5)
	STS EIFR,TEMP
	POP TEMP
	POP ACCUM
	RET
.elseif	INPUT_PORT == INT6_PORT
	BREQ PC+0x08
	STS _C5_INPUT_CHAR,TEMP
	LDS TEMP,EIMSK
	ANDI TEMP,~(1<<INT6)
	STS EIMSK,TEMP
	LDS TEMP,EIFR
	ORI TEMP,(1<<INTF6)
	STS EIFR,TEMP
	POP TEMP
	POP ACCUM
	RET
.elseif	INPUT_PORT == INT7_PORT
	BREQ PC+0x08
	STS _C5_INPUT_CHAR,TEMP
	LDS TEMP,EIMSK
	ANDI TEMP,~(1<<INT7)
	STS EIMSK,TEMP
	LDS TEMP,EIFR
	ORI TEMP,(1<<INTF7)
	STS EIFR,TEMP
	POP TEMP
	POP ACCUM
	RET
.else
	MOV ACCUM,TEMP
	POP TEMP
	BREQ _INPUT_GET_CHAR__REPEATE
	STS _C5_INPUT_CHAR,ACCUM

	SEI

	POP ACCUM
	LDS TEMP,_C5_INPUT_CHAR
	RET
.endif


.else
	LDI TEMP,0x00
	RET
.endif
.endif
