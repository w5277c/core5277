;-----------------------------------------------------------------------------------------------------------------------
;Файл распространяется под лицензией GPL-3.0-or-later, https://www.gnu.org/licenses/gpl-3.0.txt
;-----------------------------------------------------------------------------------------------------------------------
;25.06.2021	w5277c@gmail.com			Начало
;-----------------------------------------------------------------------------------------------------------------------
.ifdef DEF_REG_BIT_SET
.else
.set DEF_REG_BIT_SET = 1

.if REPORT_INCLUDES == 0x01
.message "included REG_BIT_SET"
.endif

.include	"./io/reg_bit_hi.inc"
.include	"./io/reg_bit_lo.inc"

;--------------------------------------------------------
REG_BIT_SET:
;--------------------------------------------------------
;Установка бита для регистра
;IN: TEMP-адрес регистра, ACCUM-номер бита
;flag C-состояние бита(true = HI)
;--------------------------------------------------------
	BRCS PC+0x01+_MCALL_SIZE
	MJMP REG_BIT_LO
	MJMP REG_BIT_HI
.endif
