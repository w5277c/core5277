;-----------------------------------------------------------------------------------------------------------------------
;Файл распространяется под лицензией GPL-3.0-or-later, https://www.gnu.org/licenses/gpl-3.0.txt
;-----------------------------------------------------------------------------------------------------------------------
;05.03.2020	w5277c@gmail.com			Начало
;01.08.2020	w5277c@gmail.com			Разбиение на файлы
;27.10.2020	w5277c@gmail.com			Обновлена информация об авторских правах
;05.12.2020	w5277c@gmail.com			-с5
;-----------------------------------------------------------------------------------------------------------------------
.ifdef DEF_PORT_GET_BYTE
.else
.set DEF_PORT_GET_BYTE = 1

.if REPORT_INCLUDES == 0x01
.message "included PORT_GET_BYTE"
.endif

.include	"./io/port_offsets.inc"

;--------------------------------------------------------
PORT_GET_BYTE:
;--------------------------------------------------------
;Считывание состояния порта(8 бит)
;IN: ACCUM - порт
;OUT: ACCUM - значение
;--------------------------------------------------------
	PUSH_Z
	PUSH_T16
	PUSH TEMP

	MCALL PORT_OFFSETS
	MOV ZH,C0x00
	MOV ZL,TEMP
	LD ACCUM,Z

	POP TEMP
	POP_T16
	POP_Z
	RET
.endif
