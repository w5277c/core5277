;-----------------------------------------------------------------------------------------------------------------------
;Файл распространяется под лицензией GPL-3.0-or-later, https://www.gnu.org/licenses/gpl-3.0.txt
;-----------------------------------------------------------------------------------------------------------------------
;11.10.2021	w5277c@gmail.com			Начало
;-----------------------------------------------------------------------------------------------------------------------
.ifdef DEF_PORT_SET_BYTE
.else
.set DEF_PORT_SET_BYTE = 1

.if REPORT_INCLUDES == 0x01
.message "included PORT_SET_BYTE"
.endif

.include	"./io/port_offsets.inc"

;--------------------------------------------------------
PORT_SET_BYTE:
;--------------------------------------------------------
;Запись состояния порта(8 бит)
;IN: ACCUM-порт,TEMP-значение
;--------------------------------------------------------
	PUSH_Z
	PUSH_THL

	PUSH TEMP
	MCALL PORT_OFFSETS
	POP TEMP
	MOV ZH,C0x00
	MOV ZL,TEMP_H
	ST Z,TEMP

	POP_THL
	POP_Z
	RET
.endif
