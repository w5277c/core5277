;-----------------------------------------------------------------------------------------------------------------------
;Файл распространяется под лицензией GPL-3.0-or-later, https://www.gnu.org/licenses/gpl-3.0.txt
;-----------------------------------------------------------------------------------------------------------------------
;01.08.2023	konstantin@5277.ru		Начало
;-----------------------------------------------------------------------------------------------------------------------
.ifdef DEF_REG_BIT_SSET
.else
.set DEF_REG_BIT_SSET = 1

.if REPORT_INCLUDES == 0x01
.message "included REG_BIT_SSET"
.endif

.include	"./io/reg_bit_hi.inc"
.include	"./io/reg_bit_lo.inc"

;--------------------------------------------------------
REG_BIT_SET:
;--------------------------------------------------------
;Установка бита для регистра(с учетом бита инверсии)
;IN: TEMP-адрес регистра(7бит-инверсия), ACCUM-номер бита
;flag C-состояние бита(true = HI, при 7бит-false)
;--------------------------------------------------------
	PUSH TEMP
	BRCC PC+0x02
	COM TEMP
	LSL TEMP
	POP TEMP
	BRCS PC+0x01+_MCALL_SIZE
	MJMP REG_BIT_LO
	MJMP REG_BIT_HI
.endif
