;-----------------------------------------------------------------------------------------------------------------------
;Файл распространяется под лицензией GPL-3.0-or-later, https://www.gnu.org/licenses/gpl-3.0.txt
;-----------------------------------------------------------------------------------------------------------------------
;05.03.2020  w5277c@gmail.com			Начало
;01.08.2020  w5277c@gmail.com			Разбиение на файлы
;27.10.2020  w5277c@gmail.com			Обновлена информация об авторских правах
;05.12.2020  w5277c@gmail.com			-с5
;-----------------------------------------------------------------------------------------------------------------------
.ifdef DEF_PORT_SET
.else
.set DEF_PORT_SET = 1

.include	"./io/port_set_hi.inc"
.include	"./io/port_set_lo.inc"

;--------------------------------------------------------
PORT_SET:
;--------------------------------------------------------
;Установка состояния порта
;IN: ACCUM - порт
;flag C - состояние порта(true = HI)
;--------------------------------------------------------
	BRCC PC+0x03
	MJMP PORT_SET_HI
	MJMP PORT_SET_LO
.endif
