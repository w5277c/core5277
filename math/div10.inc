;-----------------------------------------------------------------------------------------------------------------------
;Файл распространяется под лицензией GPL-3.0-or-later, https://www.gnu.org/licenses/gpl-3.0.txt
;-----------------------------------------------------------------------------------------------------------------------
;07.10.2020	w5277c@gmail.com			Начало
;27.10.2020	w5277c@gmail.com			Обновлена информация об авторских правах
;10.12.2020	w5277c@gmail.com			-с5
;29.05.2021	w5277c@gmail.com			Использование MUL8X8
;-----------------------------------------------------------------------------------------------------------------------
.ifdef DEF_DIV10
.else
.set DEF_DIV10 = 1

.if REPORT_INCLUDES == 0x01
.message "included DIV10"
.endif

.include	"./math/mul8x8.inc"

;--------------------------------------------------------
DIV10:
;--------------------------------------------------------
;Деление 8b числа на 10
;IN: TEMP-8b число
;OUT: TEMP_L-8b результат
;--------------------------------------------------------
	PUSH TEMP_H

	LDI TEMP_L,205														;204.8
	MCALL MUL8X8
	MOV TEMP_L,TEMP_H
	LSR TEMP_L
	LSR TEMP_L
	LSR TEMP_L

	POP TEMP_H
	RET
.endif
