;-----------------------------------------------------------------------------------------------------------------------
;Файл распространяется под лицензией GPL-3.0-or-later, https://www.gnu.org/licenses/gpl-3.0.txt
;-----------------------------------------------------------------------------------------------------------------------
;08.10.2020	w5277c@gmail.com			Начало
;27.10.2020	w5277c@gmail.com			Обновлена информация об авторских правах
;10.12.2020	w5277c@gmail.com			-с5
;29.05.2021	w5277c@gmail.com			Использование MUL8X8
;08.01.2022	w5277c@gmail.com			Оптимиация(существенно при программном MUL8x8)
;-----------------------------------------------------------------------------------------------------------------------
.ifdef DEF_MUL10
.else
.set DEF_MUL10 = 1

.if REPORT_INCLUDES == 0x01
.message "included MUL10"
.endif

;--------------------------------------------------------
MUL10:
;--------------------------------------------------------
;Умножение 8b числа на 10
;IN: TEMP-8b число
;OUT: TEMP_H/L-результат
;--------------------------------------------------------
	CLR TEMP_H
	MOV TEMP_L,TEMP
	LSL TEMP_L
	ROL TEMP_H
	LSL TEMP_L
	ROL TEMP_H
	LSL TEMP_L
	ROL TEMP_H
	ADD TEMP_L,TEMP
	ADC TEMP_H,C0x00
	ADD TEMP_L,TEMP
	ADC TEMP_H,C0x00

	RET
.endif
