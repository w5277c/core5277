;-----------------------------------------------------------------------------------------------------------------------
;Файл распространяется под лицензией GPL-3.0-or-later, https://www.gnu.org/licenses/gpl-3.0.txt
;-----------------------------------------------------------------------------------------------------------------------
;08.10.2020	w5277c@gmail.com			Начало
;27.10.2020	w5277c@gmail.com			Обновлена информация об авторских правах
;10.12.2020	w5277c@gmail.com			-с5
;29.05.2021	w5277c@gmail.com			Использование MUL8X8
;-----------------------------------------------------------------------------------------------------------------------
.ifdef DEF_MUL100
.else
.set DEF_MUL100 = 1

.if REPORT_INCLUDES == 0x01
.message "included MUL100"
.endif

.include	"./math/mul8x8.inc"

;--------------------------------------------------------
MUL100:
;--------------------------------------------------------
;Умножение 8b числа на 100
;IN: TEMP-8b число
;OUT: TEMP_H/L-результат
;--------------------------------------------------------
	LDI TEMP_L,0x64
	MCALL MUL8X8
	RET
.endif
