;-----------------------------------------------------------------------------------------------------------------------
;Файл распространяется под лицензией GPL-3.0-or-later, https://www.gnu.org/licenses/gpl-3.0.txt
;-----------------------------------------------------------------------------------------------------------------------
;07.10.2020	w5277c@gmail.com			Начало
;08.10.2020	w5277c@gmail.com			Все плохо, храмает точность, например для 59942
;27.10.2020	w5277c@gmail.com			Обновлена информация об авторских правах
;10.12.2020	w5277c@gmail.com			-с5
;03.07.2021	w5277c@gmail.com			Основа div16x8
;-----------------------------------------------------------------------------------------------------------------------

.ifdef DEF_DIV100
.else
.set DEF_DIV100 = 1

.if REPORT_INCLUDES == 0x01
.message "included DIV100"
.endif

.include	"./math/div16x8.inc"

;--------------------------------------------------------
DIV100:
;--------------------------------------------------------
;Деление 16b числа на 100
;IN: TEMP_H/TEMP_L-16b число
;OUT: TEMP_H/TEMP_L-результат
;--------------------------------------------------------
	PUSH TEMP
	LDI TEMP,0x64
	MCALL DIV16X8
	POP TEMP
	RET
.endif
